/dts-v1/;

/ {

	__fixups__ {
		accdet = "/fragment@13:target:0";
		auxadc = "/fragment@28:target:0", "/fragment@29/__overlay__:io-channels:0";
		chipone_fp = "/fragment@6:target:0";
		chosen = "/fragment@9:target:0";
		consys = "/fragment@19:target:0";
		dsi_err_flag = "/fragment@43:target:0";
		dsi_te = "/fragment@50:target:0";
		flashlights_led191 = "/fragment@70:target:0";
		fpsensor_finger = "/fragment@4:target:0";
		fpsensor_fp_eint = "/fragment@44:target:0";
		goodix_fp = "/fragment@45:target:0";
		gpio = "/fragment@41:target:0";
		gpio_usage_mapping = "/fragment@40:target:0";
		i2c0 = "/fragment@26:target:0", "/fragment@31:target:0";
		i2c1 = "/fragment@32:target:0";
		i2c2 = "/fragment@11:target:0", "/fragment@33:target:0", "/fragment@66:target:0", "/fragment@68:target:0";
		i2c3 = "/fragment@12:target:0", "/fragment@34:target:0";
		i2c4 = "/fragment@35:target:0", "/fragment@69:target:0";
		i2c5 = "/fragment@36:target:0";
		i2c6 = "/fragment@37:target:0";
		i2c7 = "/fragment@38:target:0";
		i2c8 = "/fragment@39:target:0";
		irtx_pwm = "/fragment@20:target:0";
		kd_camera_hw1 = "/fragment@62:target:0", "/fragment@67:target:0";
		keypad = "/fragment@14:target:0", "/fragment@64:target:0";
		main_pmic = "/fragment@52:target:0";
		md1_sim1_hot_plug_eint = "/fragment@53:target:0";
		md1_sim2_hot_plug_eint = "/fragment@54:target:0";
		md_auxadc = "/fragment@29:target:0";
		mmc1 = "/fragment@27:target:0";
		mt6370_pmu = "/fragment@16:target:0";
		mt6370_typec = "/fragment@17:target:0";
		mt_pmic_vcama1_ldo_reg = "/fragment@55:target:0", "/fragment@62/__overlay__:vcama-supply:0", "/fragment@67/__overlay__:cam0_vcama-supply:0", "/fragment@67/__overlay__:cam2_vcama-supply:0", "/fragment@68/__overlay__/gc6133c_yuv@40:vcama-supply:0", "/fragment@68/__overlay__/bf30a2_yuv@6e:vcama-supply:0";
		mt_pmic_vcama2_ldo_reg = "/fragment@56:target:0", "/fragment@62/__overlay__:vcama_sub-supply:0", "/fragment@67/__overlay__:cam1_vcama-supply:0", "/fragment@69/__overlay__/gc6133c_yuv_i2c4@40:vcama-supply:0", "/fragment@69/__overlay__/bf30a2_yuv_i2c4@6e:vcama-supply:0";
		mt_pmic_vcamd_ldo_reg = "/fragment@59:target:0", "/fragment@62/__overlay__:vcamd_main2-supply:0", "/fragment@67/__overlay__:cam0_vcamd-supply:0";
		mt_pmic_vcamio_ldo_reg = "/fragment@60:target:0", "/fragment@62/__overlay__:vcamio-supply:0", "/fragment@62/__overlay__:vcamio_sub-supply:0", "/fragment@62/__overlay__:vcamio_main2-supply:0", "/fragment@67/__overlay__:cam0_vcamio-supply:0", "/fragment@67/__overlay__:cam1_vcamio-supply:0", "/fragment@67/__overlay__:cam2_vcamio-supply:0", "/fragment@68/__overlay__/gc6133c_yuv@40:vcamio-supply:0", "/fragment@68/__overlay__/bf30a2_yuv@6e:vcamio-supply:0", "/fragment@69/__overlay__/gc6133c_yuv_i2c4@40:vcamio-supply:0", "/fragment@69/__overlay__/bf30a2_yuv_i2c4@6e:vcamio-supply:0";
		mt_pmic_vldo28_ldo_reg = "/fragment@61:target:0", "/fragment@62/__overlay__:vcamaf-supply:0", "/fragment@67/__overlay__:cam0_vcamaf-supply:0";
		mt_pmic_vsim1_ldo_reg = "/fragment@57:target:0";
		mt_pmic_vsim2_ldo_reg = "/fragment@58:target:0";
		mtkfb = "/fragment@24:target:0";
		odm = "/fragment@10:target:0", "/fragment@74:target:0";
		panel = "/fragment@25:target:0";
		pio = "/fragment@1/__overlay__:int_gpio:0", "/fragment@2:target:0", "/fragment@3:target:0", "/fragment@5:target:0", "/fragment@6/__overlay__:int_fpgpio:0", "/fragment@7:target:0", "/fragment@12/__overlay__/nxp@28:nq-irq:0", "/fragment@12/__overlay__/nxp@28:interrupt-parent:0", "/fragment@12/__overlay__/nxp@28:nq-ven:0", "/fragment@12/__overlay__/nxp@28:nq-firm:0", "/fragment@12/__overlay__/nxp@28:nq-clkreq:0", "/fragment@15:target:0", "/fragment@16/__overlay__:mt6370,intr_gpio:0", "/fragment@17/__overlay__:mt6370pd,intr_gpio:0", "/fragment@18:target:0", "/fragment@21:target:0", "/fragment@22:target:0", "/fragment@23:target:0", "/fragment@25/__overlay__:panel,gpio_lcd_rst:0", "/fragment@25/__overlay__:panel,gpio_lcd_bias_enp:0", "/fragment@25/__overlay__:panel,gpio_lcd_bias_enn:0", "/fragment@27/__overlay__:cd-gpios:0", "/fragment@40/__overlay__:GPIO_FDD_BAND_SUPPORT_DETECT_5TH_PIN:0", "/fragment@40/__overlay__:GPIO_FDD_BAND_SUPPORT_DETECT_4TH_PIN:0", "/fragment@40/__overlay__:GPIO_SIM2_HOT_PLUG:0", "/fragment@40/__overlay__:GPIO_SIM1_HOT_PLUG:0", "/fragment@40/__overlay__:GPIO_FDD_BAND_SUPPORT_DETECT_2ND_PIN:0", "/fragment@40/__overlay__:GPIO_FDD_BAND_SUPPORT_DETECT_1ST_PIN:0", "/fragment@40/__overlay__:GPIO_FDD_BAND_SUPPORT_DETECT_3RD_PIN:0", "/fragment@40/__overlay__:GPIO_SIM2_SIO:0", "/fragment@40/__overlay__:GPIO_SIM2_SRST:0", "/fragment@40/__overlay__:GPIO_SIM2_SCLK:0", "/fragment@40/__overlay__:GPIO_SIM1_SCLK:0", "/fragment@40/__overlay__:GPIO_SIM1_SRST:0", "/fragment@40/__overlay__:GPIO_SIM1_SIO:0", "/fragment@40/__overlay__:GPIO_FDD_BAND_SUPPORT_DETECT_6TH_PIN:0", "/fragment@42/__overlay__:interrupt-parent:0", "/fragment@43/__overlay__:interrupt-parent:0", "/fragment@44/__overlay__:interrupt-parent:0", "/fragment@45/__overlay__:interrupt-parent:0", "/fragment@46/__overlay__:interrupt-parent:0", "/fragment@47/__overlay__:interrupt-parent:0", "/fragment@48/__overlay__:interrupt-parent:0", "/fragment@49/__overlay__:interrupt-parent:0", "/fragment@50/__overlay__:interrupt-parent:0", "/fragment@51/__overlay__:interrupt-parent:0", "/fragment@51/__overlay__:deb-gpios:0", "/fragment@52/__overlay__:interrupt-parent:0", "/fragment@65:target:0", "/fragment@71:target:0", "/fragment@72/__overlay__/novatek@0:novatek,reset-gpio:0", "/fragment@72/__overlay__/novatek@0:novatek,irq-gpio:0", "/fragment@72/__overlay__/novatek@0:focaltech,reset-gpio:0", "/fragment@72/__overlay__/novatek@0:focaltech,irq-gpio:0", "/fragment@72/__overlay__/novatek@0:chipone,rst-gpio:0", "/fragment@72/__overlay__/novatek@0:chipone,irq-gpio:0", "/fragment@73:target:0", "/fragment@74/__overlay__/fs15xx:fsm,id-gpio:0", "/fragment@74/__overlay__/fs15xx:fsm,cmd-gpio:0", "/fragment@74/__overlay__/fs15xx:fsm,mod-gpio:0";
		pmic_clock_buffer_ctrl = "/fragment@30:target:0";
		reserved_memory = "/fragment@8:target:0";
		rt9465_slave_chr = "/fragment@49:target:0";
		silead_fp = "/fragment@1:target:0";
		smart_pa = "/fragment@47:target:0";
		spi0 = "/fragment@72:target:0";
		spi2 = "/fragment@0:target:0";
		subpmic_pmu_eint = "/fragment@46:target:0";
		swtp = "/fragment@51:target:0";
		tcpc_pd = "/fragment@48:target:0";
		touch = "/fragment@42:target:0", "/fragment@63:target:0";
	};

	__local_fixups__ {

		fragment@1 {

			__overlay__ {
				pinctrl-0 = <0x0>;
				pinctrl-1 = <0x0>;
				pinctrl-2 = <0x0>;
				pinctrl-3 = <0x0>;
				pinctrl-4 = <0x0>;
				pinctrl-5 = <0x0>;
				pinctrl-6 = <0x0>;
				pinctrl-7 = <0x0>;
				pinctrl-8 = <0x0>;
			};
		};

		fragment@14 {

			__overlay__ {
				pinctrl-0 = <0x0>;
			};
		};

		fragment@19 {

			__overlay__ {
				pinctrl-0 = <0x0>;
				pinctrl-1 = <0x0>;
				pinctrl-2 = <0x0>;
				pinctrl-3 = <0x0>;
			};
		};

		fragment@20 {

			__overlay__ {
				pinctrl-0 = <0x0>;
				pinctrl-1 = <0x0>;
			};
		};

		fragment@24 {

			__overlay__ {
				pinctrl-0 = <0x0>;
				pinctrl-1 = <0x0>;
				pinctrl-2 = <0x0>;
			};
		};

		fragment@25 {

			__overlay__ {
				pinctrl-0 = <0x0>;
				pinctrl-1 = <0x0>;
			};
		};

		fragment@4 {

			__overlay__ {
				pinctrl-0 = <0x0>;
				pinctrl-1 = <0x0>;
				pinctrl-2 = <0x0>;
			};
		};

		fragment@6 {

			__overlay__ {
				pinctrl-0 = <0x0>;
				pinctrl-1 = <0x0>;
				pinctrl-10 = <0x0>;
				pinctrl-11 = <0x0>;
				pinctrl-12 = <0x0>;
				pinctrl-13 = <0x0>;
				pinctrl-14 = <0x0>;
				pinctrl-15 = <0x0>;
				pinctrl-16 = <0x0>;
				pinctrl-17 = <0x0>;
				pinctrl-2 = <0x0>;
				pinctrl-3 = <0x0>;
				pinctrl-4 = <0x0>;
				pinctrl-5 = <0x0>;
				pinctrl-6 = <0x0>;
				pinctrl-7 = <0x0>;
				pinctrl-8 = <0x0>;
				pinctrl-9 = <0x0>;
			};
		};

		fragment@67 {

			__overlay__ {
				pinctrl-0 = <0x0>;
				pinctrl-1 = <0x0>;
				pinctrl-10 = <0x0>;
				pinctrl-11 = <0x0>;
				pinctrl-12 = <0x0>;
				pinctrl-13 = <0x0>;
				pinctrl-14 = <0x0>;
				pinctrl-15 = <0x0>;
				pinctrl-16 = <0x0>;
				pinctrl-17 = <0x0>;
				pinctrl-18 = <0x0>;
				pinctrl-19 = <0x0>;
				pinctrl-2 = <0x0>;
				pinctrl-20 = <0x0>;
				pinctrl-3 = <0x0>;
				pinctrl-4 = <0x0>;
				pinctrl-5 = <0x0>;
				pinctrl-6 = <0x0>;
				pinctrl-7 = <0x0>;
				pinctrl-8 = <0x0>;
				pinctrl-9 = <0x0>;
			};
		};

		fragment@68 {

			__overlay__ {

				bf30a2_yuv@6e {
					pinctrl-0 = <0x0>;
					pinctrl-1 = <0x0>;
					pinctrl-2 = <0x0>;
				};

				gc6133c_yuv@40 {
					pinctrl-0 = <0x0>;
					pinctrl-1 = <0x0>;
					pinctrl-2 = <0x0>;
				};
			};
		};

		fragment@69 {

			__overlay__ {

				bf30a2_yuv_i2c4@6e {
					pinctrl-0 = <0x0>;
					pinctrl-1 = <0x0>;
					pinctrl-2 = <0x0>;
				};

				gc6133c_yuv_i2c4@40 {
					pinctrl-0 = <0x0>;
					pinctrl-1 = <0x0>;
					pinctrl-2 = <0x0>;
				};
			};
		};

		fragment@70 {

			__overlay__ {
				pinctrl-0 = <0x0>;
				pinctrl-1 = <0x0>;
				pinctrl-2 = <0x0>;
			};
		};

		fragment@74 {

			__overlay__ {

				fs15xx {
					pinctrl-0 = <0x0>;
					pinctrl-1 = <0x0>;
					pinctrl-2 = <0x0>;
				};
			};
		};
	};

	__symbols__ {
		camera0_mclk_2mA = "/fragment@65/__overlay__/camera0_mclk_2mA@gpio100";
		camera0_mclk_4mA = "/fragment@65/__overlay__/camera0_mclk_4mA@gpio100";
		camera0_mclk_6mA = "/fragment@65/__overlay__/camera0_mclk_6mA@gpio100";
		camera0_mclk_8mA = "/fragment@65/__overlay__/camera0_mclk_8mA@gpio100";
		camera0_mclk_off = "/fragment@65/__overlay__/camera0_mclk_gpio_mode@gpio100";
		camera0_rst_high = "/fragment@65/__overlay__/camera0_rst_output_high@gpio102";
		camera0_rst_low = "/fragment@65/__overlay__/camera0_rst_output_low@gpio102";
		camera1_mclk_2mA = "/fragment@65/__overlay__/camera1_mclk_2mA@gpio108";
		camera1_mclk_4mA = "/fragment@65/__overlay__/camera1_mclk_4mA@gpio108";
		camera1_mclk_6mA = "/fragment@65/__overlay__/camera1_mclk_6mA@gpio108";
		camera1_mclk_8mA = "/fragment@65/__overlay__/camera1_mclk_8mA@gpio108";
		camera1_mclk_off = "/fragment@65/__overlay__/camera1_mclk_gpio_mode@gpio108";
		camera1_rst_high = "/fragment@65/__overlay__/camera1_rst_output_high@gpio109";
		camera1_rst_low = "/fragment@65/__overlay__/camera1_rst_output_low@gpio109";
		camera1_vcamd_off = "/fragment@65/__overlay__/camera1_vcamd_output_low@gpio158";
		camera1_vcamd_on = "/fragment@65/__overlay__/camera1_vcamd_output_high@gpio158";
		camera2_mclk_2mA = "/fragment@65/__overlay__/camera2_mclk_2mA@gpio111";
		camera2_mclk_4mA = "/fragment@65/__overlay__/camera2_mclk_4mA@gpio111";
		camera2_mclk_6mA = "/fragment@65/__overlay__/camera2_mclk_6mA@gpio111";
		camera2_mclk_8mA = "/fragment@65/__overlay__/camera2_mclk_8mA@gpio111";
		camera2_mclk_off = "/fragment@65/__overlay__/camera2_mclk_gpio_off@gpio111";
		camera2_mclk_on = "/fragment@65/__overlay__/camera2_mclk_gpio_on@gpio111";
		camera2_pdn_high = "/fragment@65/__overlay__/camera2_pdn_output_high@gpio110";
		camera2_pdn_low = "/fragment@65/__overlay__/camera2_pdn_output_low@gpio110";
		camera2_rst_high = "/fragment@65/__overlay__/camera2_rst_output_high@gpio112";
		camera2_rst_low = "/fragment@65/__overlay__/camera2_rst_output_low@gpio112";
		camera_main_af_mtk = "/fragment@33/__overlay__/camera_main_af@0c";
		camera_main_eeprom_mtk = "/fragment@33/__overlay__/camera_main_eeprom@50";
		camera_main_mtk = "/fragment@33/__overlay__/camera_main@1a";
		camera_main_two_eeprom_mtk = "/fragment@34/__overlay__/camera_main_two_eeprom@50";
		camera_main_two_mtk = "/fragment@33/__overlay__/camera_main_two@10";
		camera_pins_default = "/fragment@65/__overlay__/camdefault";
		camera_sub_eeprom_mtk = "/fragment@35/__overlay__/camera_sub_eeprom@52";
		camera_sub_mtk = "/fragment@35/__overlay__/camera_sub@2d";
		ccu_sensor_i2c_2_hw_mtk = "/fragment@33/__overlay__/ccu_sensor_i2c_2_hw@11";
		ccu_sensor_i2c_4_hw_mtk = "/fragment@35/__overlay__/ccu_sensor_i2c_4_hw@12";
		consys_pins_default = "/fragment@18/__overlay__/consys_default";
		fingerprint_pins_default = "/fragment@3/__overlay__/fp_default";
		flashlight_pins_default = "/fragment@71/__overlay__/flashlightdefault";
		flashlight_pins_en_output0 = "/fragment@71/__overlay__/flashlightenoutput0";
		flashlight_pins_en_output1 = "/fragment@71/__overlay__/flashlightenoutput1";
		fpsensor_finger_cs_mode_en0 = "/fragment@7/__overlay__/fpsensor_finger_cs_low";
		fpsensor_finger_cs_mode_en1 = "/fragment@7/__overlay__/fpsensor_finger_cs_high";
		fpsensor_finger_power_en0 = "/fragment@7/__overlay__/fpsensor_finger_power_low";
		fpsensor_finger_power_en1 = "/fragment@7/__overlay__/fpsensor_finger_power_high";
		fpsensor_finger_rst_mode_en0 = "/fragment@7/__overlay__/fpsensor_finger_rst_low";
		fpsensor_finger_rst_mode_en1 = "/fragment@7/__overlay__/fpsensor_finger_rst_high";
		fpsensor_fp_eint_as_int = "/fragment@7/__overlay__/fpsensor_eint_as_int";
		fpsensor_fp_eint_in_float = "/fragment@7/__overlay__/fpsensor_eint_in_float";
		fpsensor_fp_eint_in_low = "/fragment@7/__overlay__/fpsensor_eint_in_low";
		fpsensor_fp_power_high = "/fragment@5/__overlay__/fpsensor_fp_power_high";
		fpsensor_fpc_rst_high = "/fragment@5/__overlay__/fpsensor_fpc_rst_high";
		fpsensor_fpc_rst_low = "/fragment@5/__overlay__/fpsensor_fpc_rst_low";
		fpsensor_spi_cs_en0 = "/fragment@7/__overlay__/fpsensor_spi_cs_low";
		fpsensor_spi_cs_en1 = "/fragment@7/__overlay__/fpsensor_spi_cs_high";
		fpsensor_spi_default = "/fragment@7/__overlay__/fpsensor_spi_default";
		fpsensor_spi_mclk_mode_en0 = "/fragment@7/__overlay__/fpsensor_spi_mclk_low";
		fpsensor_spi_mclk_mode_en1 = "/fragment@7/__overlay__/fpsensor_spi_mclk_high";
		fpsensor_spi_mi_mode_en0 = "/fragment@7/__overlay__/fpsensor_spi_mi_low";
		fpsensor_spi_mi_mode_en1 = "/fragment@7/__overlay__/fpsensor_spi_mi_high";
		fpsensor_spi_mo_mode_en0 = "/fragment@7/__overlay__/fpsensor_spi_mo_low";
		fpsensor_spi_mo_mode_en1 = "/fragment@7/__overlay__/fpsensor_spi_mo_high";
		fs15xx = "/fragment@74/__overlay__/fs15xx";
		fs15xx_cmd = "/fragment@73/__overlay__/fs15xx_cmd";
		fs15xx_id = "/fragment@73/__overlay__/fs15xx_id";
		fs15xx_mod = "/fragment@73/__overlay__/fs15xx_mod";
		gpslna_pins_init = "/fragment@18/__overlay__/gpslna@0";
		gpslna_pins_oh = "/fragment@18/__overlay__/gpslna@1";
		gpslna_pins_ol = "/fragment@18/__overlay__/gpslna@2";
		irtx_gpio_led_default = "/fragment@21/__overlay__/irtx_gpio_led_def@gpio12";
		irtx_gpio_led_set = "/fragment@21/__overlay__/irtx_gpio_led_set@gpio12";
		kpd_pins_default = "/fragment@15/__overlay__/kpdgpiodefault";
		lcd_disp_pwm = "/fragment@23/__overlay__/lcd_disp_pwm";
		lcd_disp_pwm_gpio = "/fragment@23/__overlay__/lcd_disp_pwm_gpio";
		led0 = "/fragment@10/__overlay__/led@0";
		led1 = "/fragment@10/__overlay__/led@1";
		led2 = "/fragment@10/__overlay__/led@2";
		led3 = "/fragment@10/__overlay__/led@3";
		led4 = "/fragment@10/__overlay__/led@4";
		led5 = "/fragment@10/__overlay__/led@5";
		led6 = "/fragment@10/__overlay__/led@6";
		mtk_camera_eeprom0 = "/fragment@66/__overlay__/camera_eeprom0@50";
		mtkfb_pins_lcm_dsi_te = "/fragment@22/__overlay__/lcm_dsi_te";
		mtkfb_pins_lcm_rst_out0_gpio = "/fragment@22/__overlay__/lcm_rst_out0_gpio";
		mtkfb_pins_lcm_rst_out1_gpio = "/fragment@22/__overlay__/lcm_rst_out1_gpio";
		nfc_mtk = "/fragment@34/__overlay__/nfc@08";
		silfp_avdd_high = "/fragment@2/__overlay__/state_avdd_high";
		silfp_avdd_low = "/fragment@2/__overlay__/state_avdd_low";
		silfp_default = "/fragment@2/__overlay__/silfpdefault";
		silfp_irq = "/fragment@2/__overlay__/fp_eint@8";
		silfp_irq_rst_high = "/fragment@2/__overlay__/state_irq_to_reset_high";
		silfp_irq_rst_low = "/fragment@2/__overlay__/state_irq_to_reset_low";
		silfp_rst_high = "/fragment@2/__overlay__/state_reset_high";
		silfp_rst_low = "/fragment@2/__overlay__/state_reset_low";
		slave_charger_mtk = "/fragment@38/__overlay__/slave_charger@4b";
		subpmic_pmu_mtk = "/fragment@36/__overlay__/subpmic_pmu@34";
		usb_type_c_mtk = "/fragment@36/__overlay__/usb_type_c@4e";
		vibrator0 = "/fragment@10/__overlay__/vibrator@0";
	};

	fragment@0 {
		target = <0xffffffff>;

		__overlay__ {
			#address-cells = <0x1>;
			#size-cells = <0x0>;
			cs-gpios = <0x0 0x0 0x0 0x0>;
			mediatek,pad-select = <0x0 0x0 0x0 0x0>;
			status = "okay";

			chipone_fpsensor@1 {
				compatible = "mediatek,chipone-sidefp";
				reg = <0x1>;
				spi-max-frequency = <0x989680>;
				status = "okay";
			};

			fpc_tee@0 {
				compatible = "fpc,fpc_spi";
				fpc,enable-wakeup;
				netlink-event = <0x1f>;
				reg = <0x0>;
				spi-max-frequency = <0x989680>;
				status = "okay";
			};
		};
	};

	fragment@1 {
		target = <0xffffffff>;

		__overlay__ {
			int_gpio = <0xffffffff 0x8 0x0>;
			pinctrl-0 = <0x1>;
			pinctrl-1 = <0x2>;
			pinctrl-2 = <0x3>;
			pinctrl-3 = <0x4>;
			pinctrl-4 = <0x5>;
			pinctrl-5 = <0x6>;
			pinctrl-6 = <0x7>;
			pinctrl-7 = <0x8>;
			pinctrl-8 = <0x9>;
			pinctrl-names = "default", "rst-low", "rst-high", "irq-init", "spi-default", "irq_rst-low", "irq_rst-high", "avdd-enable", "avdd-disable";
			status = "okay";
		};
	};

	fragment@10 {
		target = <0xffffffff>;

		__overlay__ {

			led@0 {
				compatible = "mediatek,red";
				data = <0x1>;
				led_mode = <0x0>;
				phandle = <0x48>;
				pwm_config = <0x0 0x0 0x0 0x0 0x0>;
			};

			led@1 {
				compatible = "mediatek,green";
				data = <0x1>;
				led_mode = <0x0>;
				phandle = <0x49>;
				pwm_config = <0x0 0x0 0x0 0x0 0x0>;
			};

			led@2 {
				compatible = "mediatek,blue";
				data = <0x1>;
				led_mode = <0x0>;
				phandle = <0x4a>;
				pwm_config = <0x0 0x0 0x0 0x0 0x0>;
			};

			led@3 {
				compatible = "mediatek,jogball-backlight";
				data = <0x1>;
				led_mode = <0x0>;
				phandle = <0x4b>;
				pwm_config = <0x0 0x0 0x0 0x0 0x0>;
			};

			led@4 {
				compatible = "mediatek,keyboard-backlight";
				data = <0x1>;
				led_mode = <0x0>;
				phandle = <0x4c>;
				pwm_config = <0x0 0x0 0x0 0x0 0x0>;
			};

			led@5 {
				compatible = "mediatek,button-backlight";
				data = <0x1>;
				led_mode = <0x0>;
				phandle = <0x4d>;
				pwm_config = <0x0 0x0 0x0 0x0 0x0>;
			};

			led@6 {
				compatible = "mediatek,lcd-backlight";
				data = <0x1>;
				led_mode = <0x5>;
				phandle = <0x4e>;
				pwm_config = <0x0 0x1 0x0 0x0 0x0>;
			};

			vibrator@0 {
				compatible = "mediatek,vibrator";
				phandle = <0x4f>;
				vib_limit = <0x9>;
				vib_timer = <0x19>;
				vib_vol = <0xb>;
			};
		};
	};

	fragment@11 {
		target = <0xffffffff>;

		__overlay__ {
			clock-frequency = <0x61a80>;

			mtk-usb@60 {
				compatible = "mediatek,mtk-usb";
				reg = <0x60>;
				status = "okay";
			};
		};
	};

	fragment@12 {
		target = <0xffffffff>;

		__overlay__ {

			nxp@28 {
				compatible = "nq-nci";
				interrupt-names = "irq_nfc";
				interrupt-parent = <0xffffffff>;
				interrupts = <0x9 0x4 0x9 0x0>;
				nq-clkreq = <0xffffffff 0xb 0x0>;
				nq-firm = <0xffffffff 0x11 0x0>;
				nq-irq = <0xffffffff 0x9 0x0>;
				nq-ven = <0xffffffff 0x9f 0x0>;
				reg = <0x28>;
				status = "okay";
			};
		};
	};

	fragment@13 {
		target = <0xffffffff>;

		__overlay__ {
			accdet-mic-mode = <0x1>;
			accdet-mic-vol = <0x6>;
			accdet-plugout-debounce = <0x1>;
			headset-eint-level-pol = <0x8>;
			headset-four-key-threshold = <0x0 0x3a 0x79 0xc0 0x190>;
			headset-mode-setting = <0x500 0x500 0x1 0x1f0 0x800 0x800 0x20 0x44>;
			headset-three-key-threshold = <0x0 0x50 0xdc 0x190>;
			headset-three-key-threshold-CDD = <0x0 0x79 0xc0 0x258>;
			status = "okay";
		};
	};

	fragment@14 {
		target = <0xffffffff>;

		__overlay__ {
			pinctrl-0 = <0x1f>;
			pinctrl-names = "default";
		};
	};

	fragment@15 {
		target = <0xffffffff>;

		__overlay__ {

			kpdgpiodefault {
				phandle = <0x1f>;

				pins_cmd_dat {
					bias-pull-up = <0x66>;
					input-enable;
					input-schmitt-enable;
					pinmux = <0x5d01>;
				};
			};
		};
	};

	fragment@16 {
		target = <0xffffffff>;

		__overlay__ {
			mt6370,intr_gpio = <0xffffffff 0x14 0x0>;
			mt6370,intr_gpio_num = <0x14>;
		};
	};

	fragment@17 {
		target = <0xffffffff>;

		__overlay__ {
			mt6370pd,intr_gpio = <0xffffffff 0x29 0x0>;
			mt6370pd,intr_gpio_num = <0x29>;
		};
	};

	fragment@18 {
		target = <0xffffffff>;

		__overlay__ {

			consys_default {
				phandle = <0x20>;
			};

			gpslna@0 {
				phandle = <0x21>;

				pins_cmd_dat {
					bias-disable;
					output-low;
					pinmux = <0x5e00>;
					slew-rate = <0x0>;
				};
			};

			gpslna@1 {
				phandle = <0x22>;

				pins_cmd_dat {
					output-high;
					pinmux = <0x5e00>;
					slew-rate = <0x1>;
				};
			};

			gpslna@2 {
				phandle = <0x23>;

				pins_cmd_dat {
					output-low;
					pinmux = <0x5e00>;
					slew-rate = <0x1>;
				};
			};
		};
	};

	fragment@19 {
		target = <0xffffffff>;

		__overlay__ {
			pinctrl-0 = <0x20>;
			pinctrl-1 = <0x21>;
			pinctrl-2 = <0x22>;
			pinctrl-3 = <0x23>;
			pinctrl-names = "default", "gps_lna_state_init", "gps_lna_state_oh", "gps_lna_state_ol";
			status = "okay";
		};
	};

	fragment@2 {
		target = <0xffffffff>;

		__overlay__ {

			fp_eint@8 {
				phandle = <0x4>;

				pins_cmd_dat {
					bias-pull-down = <0x0>;
					pinmux = <0x800>;
					slew-rate = <0x0>;
				};
			};

			silfpdefault {
				phandle = <0x1>;
			};

			state_avdd_high {
				phandle = <0x8>;

				pins_cmd_dat {
					output-high;
					pinmux = <0xa000>;
					slew-rate = <0x1>;
				};
			};

			state_avdd_low {
				phandle = <0x9>;

				pins_cmd_dat {
					output-low;
					pinmux = <0xa000>;
					slew-rate = <0x1>;
				};
			};

			state_irq_to_reset_high {
				phandle = <0x7>;

				pins_cmd_dat {
					output-high;
					pinmux = <0x800>;
					slew-rate = <0x1>;
				};
			};

			state_irq_to_reset_low {
				phandle = <0x6>;

				pins_cmd_dat {
					output-low;
					pinmux = <0x800>;
					slew-rate = <0x1>;
				};
			};

			state_reset_high {
				phandle = <0x3>;

				pins_cmd_dat {
					output-high;
					pinmux = <0x1f00>;
					slew-rate = <0x1>;
				};
			};

			state_reset_low {
				phandle = <0x2>;

				pins_cmd_dat {
					output-low;
					pinmux = <0x1f00>;
					slew-rate = <0x1>;
				};
			};
		};
	};

	fragment@20 {
		target = <0xffffffff>;

		__overlay__ {
			pinctrl-0 = <0x24>;
			pinctrl-1 = <0x25>;
			pinctrl-names = "irtx_gpio_led_default", "irtx_gpio_led_set";
			status = "okay";
		};
	};

	fragment@21 {
		target = <0xffffffff>;

		__overlay__ {

			irtx_gpio_led_def@gpio12 {
				phandle = <0x24>;

				pins_cmd_dat {
					bias-disable;
					input-schmitt-enable = <0x0>;
					output-low;
					pinmux = <0xc00>;
					slew-rate = <0x1>;
				};
			};

			irtx_gpio_led_set@gpio12 {
				phandle = <0x25>;

				pins_cmd_dat {
					output-high;
					pinmux = <0xc01>;
					slew-rate = <0x1>;
				};
			};
		};
	};

	fragment@22 {
		target = <0xffffffff>;

		__overlay__ {

			lcm_dsi_te {
				phandle = <0x28>;

				pins_cmd_dat {
					pinmux = <0x2c01>;
				};
			};

			lcm_rst_out0_gpio {
				phandle = <0x27>;

				pins_cmd_dat {
					output-low;
					pinmux = <0x2d00>;
					slew-rate = <0x1>;
				};
			};

			lcm_rst_out1_gpio {
				phandle = <0x26>;

				pins_cmd_dat {
					output-high;
					pinmux = <0x2d00>;
					slew-rate = <0x1>;
				};
			};
		};
	};

	fragment@23 {
		target = <0xffffffff>;

		__overlay__ {

			lcd_disp_pwm {
				phandle = <0x29>;

				pins_cmd_dat {
					pinmux = <0x2b01>;
				};
			};

			lcd_disp_pwm_gpio {
				phandle = <0x2a>;

				pins_cmd_dat {
					bias-disable;
					input-disable;
					output-low;
					pinmux = <0x2b00>;
				};
			};
		};
	};

	fragment@24 {
		target = <0xffffffff>;

		__overlay__ {
			pinctrl-0 = <0x26>;
			pinctrl-1 = <0x27>;
			pinctrl-2 = <0x28>;
			pinctrl-names = "lcm_rst_out1_gpio", "lcm_rst_out0_gpio", "mode_te_te";
			status = "okay";
		};
	};

	fragment@25 {
		target = <0xffffffff>;

		__overlay__ {
			panel,gpio_lcd_bias_enn = <0xffffffff 0xa5 0x0>;
			panel,gpio_lcd_bias_enp = <0xffffffff 0xa9 0x0>;
			panel,gpio_lcd_rst = <0xffffffff 0x2d 0x0>;
			pinctrl-0 = <0x29>;
			pinctrl-1 = <0x2a>;
			pinctrl-names = "disp_pwm", "disp_pwm_gpio";
			status = "okay";
		};
	};

	fragment@26 {
		target = <0xffffffff>;

		__overlay__ {

			lcd_bias@3e {
				compatible = "mediatek,lcd_bias";
				reg = <0x3e>;
				status = "okay";
			};
		};
	};

	fragment@27 {
		target = <0xffffffff>;

		__overlay__ {
			cd-gpios = <0xffffffff 0x12 0x0>;
		};
	};

	fragment@28 {
		target = <0xffffffff>;

		__overlay__ {

			adc_channel@ {
				compatible = "mediatek,adc_channel";
				mediatek,adc_fdd_rf_params_dynamic_custom_ch = <0x2>;
				mediatek,temperature0 = <0x0>;
				mediatek,temperature1 = <0x1>;
				status = "okay";
			};
		};
	};

	fragment@29 {
		target = <0xffffffff>;

		__overlay__ {
			io-channels = <0xffffffff 0x2>;
		};
	};

	fragment@3 {
		target = <0xffffffff>;

		__overlay__ {

			fp_default {
				phandle = <0x5>;

				pins_cmd2_dat {
					bias-pull-down;
					drive-strength = <0x2>;
					pinmux = <0x1b02>;
					slew-rate = <0x1>;
				};

				pins_cmd3_dat {
					bias-pull-down;
					pinmux = <0x1c02>;
					slew-rate = <0x0>;
				};

				pins_cmd4_dat {
					bias-pull-down;
					pinmux = <0x1a02>;
					slew-rate = <0x1>;
				};

				pins_cmd_dat {
					bias-pull-up;
					pinmux = <0x1902>;
					slew-rate = <0x1>;
				};
			};
		};
	};

	fragment@30 {
		target = <0xffffffff>;

		__overlay__ {
			mediatek,clkbuf-config = <0x2 0x1 0x1 0x2 0x0 0x0 0x0>;
			mediatek,clkbuf-driving-current = <0x1 0x1 0x1 0x1 0x1 0x1 0x1>;
			mediatek,clkbuf-quantity = <0x7>;
			status = "okay";
		};
	};

	fragment@31 {
		target = <0xffffffff>;

		__overlay__ {
			#address-cells = <0x1>;
			#size-cells = <0x0>;
			clock-frequency = <0x61a80>;
			mediatek,use-open-drain;
		};
	};

	fragment@32 {
		target = <0xffffffff>;

		__overlay__ {
			#address-cells = <0x1>;
			#size-cells = <0x0>;
			clock-frequency = <0x61a80>;
			mediatek,use-open-drain;
		};
	};

	fragment@33 {
		target = <0xffffffff>;

		__overlay__ {
			#address-cells = <0x1>;
			#size-cells = <0x0>;
			clock-frequency = <0x61a80>;
			mediatek,use-open-drain;

			camera_main@1a {
				compatible = "mediatek,camera_main";
				phandle = <0x50>;
				reg = <0x1a>;
				status = "okay";
			};

			camera_main_af@0c {
				compatible = "mediatek,camera_main_af";
				phandle = <0x52>;
				reg = <0xc>;
				status = "okay";
			};

			camera_main_eeprom@50 {
				compatible = "mediatek,camera_main_eeprom";
				phandle = <0x51>;
				reg = <0x50>;
				status = "okay";
			};

			camera_main_two@10 {
				compatible = "mediatek,camera_main_two";
				phandle = <0x53>;
				reg = <0x10>;
				status = "okay";
			};

			ccu_sensor_i2c_2_hw@11 {
				compatible = "mediatek,ccu_sensor_i2c_2_hw";
				phandle = <0x54>;
				reg = <0x11>;
				status = "okay";
			};
		};
	};

	fragment@34 {
		target = <0xffffffff>;

		__overlay__ {
			#address-cells = <0x1>;
			#size-cells = <0x0>;
			clock-frequency = <0x61a80>;
			mediatek,use-open-drain;

			camera_main_two_eeprom@50 {
				compatible = "mediatek,camera_main_two_eeprom";
				phandle = <0x56>;
				reg = <0x50>;
				status = "okay";
			};

			nfc@08 {
				compatible = "mediatek,nfc";
				phandle = <0x55>;
				reg = <0x8>;
				status = "okay";
			};
		};
	};

	fragment@35 {
		target = <0xffffffff>;

		__overlay__ {
			#address-cells = <0x1>;
			#size-cells = <0x0>;
			clock-frequency = <0x61a80>;
			mediatek,use-open-drain;

			camera_sub@2d {
				compatible = "mediatek,camera_sub";
				phandle = <0x57>;
				reg = <0x2d>;
				status = "okay";
			};

			camera_sub_eeprom@52 {
				compatible = "mediatek,camera_sub_eeprom";
				phandle = <0x58>;
				reg = <0x52>;
				status = "okay";
			};

			ccu_sensor_i2c_4_hw@12 {
				compatible = "mediatek,ccu_sensor_i2c_4_hw";
				phandle = <0x59>;
				reg = <0x12>;
				status = "okay";
			};
		};
	};

	fragment@36 {
		target = <0xffffffff>;

		__overlay__ {
			#address-cells = <0x1>;
			#size-cells = <0x0>;
			clock-frequency = <0x33e140>;
			mediatek,use-push-pull;

			subpmic_pmu@34 {
				compatible = "mediatek,subpmic_pmu";
				phandle = <0x5a>;
				reg = <0x34>;
				status = "okay";
			};

			usb_type_c@4e {
				compatible = "mediatek,usb_type_c";
				phandle = <0x5b>;
				reg = <0x4e>;
				status = "okay";
			};
		};
	};

	fragment@37 {
		target = <0xffffffff>;

		__overlay__ {
			#address-cells = <0x1>;
			#size-cells = <0x0>;
			clock-frequency = <0x61a80>;
			mediatek,use-open-drain;
		};
	};

	fragment@38 {
		target = <0xffffffff>;

		__overlay__ {
			#address-cells = <0x1>;
			#size-cells = <0x0>;
			clock-frequency = <0x61a80>;
			mediatek,use-open-drain;

			slave_charger@4b {
				compatible = "mediatek,slave_charger";
				phandle = <0x5c>;
				reg = <0x4b>;
				status = "okay";
			};
		};
	};

	fragment@39 {
		target = <0xffffffff>;

		__overlay__ {
			#address-cells = <0x1>;
			#size-cells = <0x0>;
			clock-frequency = <0x61a80>;
			mediatek,use-open-drain;
		};
	};

	fragment@4 {
		target = <0xffffffff>;

		__overlay__ {
			pinctrl-0 = <0xa>;
			pinctrl-1 = <0xb>;
			pinctrl-2 = <0xc>;
			pinctrl-names = "fpsensor_fpc_rst_low", "fpsensor_fpc_rst_high", "fpsensor_fp_power_high";
			status = "okay";
		};
	};

	fragment@40 {
		target = <0xffffffff>;

		__overlay__ {
			GPIO_FDD_BAND_SUPPORT_DETECT_1ST_PIN = <0xffffffff 0x50 0x0>;
			GPIO_FDD_BAND_SUPPORT_DETECT_2ND_PIN = <0xffffffff 0x4f 0x0>;
			GPIO_FDD_BAND_SUPPORT_DETECT_3RD_PIN = <0xffffffff 0x5b 0x0>;
			GPIO_FDD_BAND_SUPPORT_DETECT_4TH_PIN = <0xffffffff 0x6 0x0>;
			GPIO_FDD_BAND_SUPPORT_DETECT_5TH_PIN = <0xffffffff 0x5 0x0>;
			GPIO_FDD_BAND_SUPPORT_DETECT_6TH_PIN = <0xffffffff 0xb2 0x0>;
			GPIO_SIM1_HOT_PLUG = <0xffffffff 0x2f 0x0>;
			GPIO_SIM1_SCLK = <0xffffffff 0xac 0x0>;
			GPIO_SIM1_SIO = <0xffffffff 0xae 0x0>;
			GPIO_SIM1_SRST = <0xffffffff 0xad 0x0>;
			GPIO_SIM2_HOT_PLUG = <0xffffffff 0x2e 0x0>;
			GPIO_SIM2_SCLK = <0xffffffff 0x9d 0x0>;
			GPIO_SIM2_SIO = <0xffffffff 0x9b 0x0>;
			GPIO_SIM2_SRST = <0xffffffff 0x9c 0x0>;
		};
	};

	fragment@41 {
		target = <0xffffffff>;

		__overlay__ {
			gpio_init_default = <0x0 0x0 0x0 0x0 0x1 0x1 0x1 0x1 0x0 0x0 0x0 0x1 0x1 0x1 0x2 0x0 0x0 0x0 0x1 0x0 0x1 0x3 0x0 0x0 0x0 0x1 0x0 0x0 0x4 0x0 0x0 0x0 0x1 0x0 0x0 0x5 0x0 0x0 0x0 0x0 0x0 0x0 0x6 0x0 0x0 0x0 0x0 0x0 0x0 0x7 0x0 0x0 0x0 0x1 0x0 0x0 0x8 0x0 0x0 0x0 0x1 0x0 0x1 0x9 0x0 0x0 0x0 0x1 0x0 0x0 0xa 0x0 0x0 0x0 0x1 0x1 0x0 0xb 0x1 0x0 0x0 0x1 0x0 0x0 0xc 0x2 0x0 0x0 0x1 0x0 0x0 0xd 0x2 0x0 0x0 0x1 0x0 0x0 0xe 0x2 0x1 0x0 0x0 0x0 0x0 0xf 0x2 0x1 0x0 0x0 0x0 0x0 0x10 0x2 0x1 0x0 0x0 0x0 0x0 0x11 0x0 0x0 0x0 0x1 0x0 0x1 0x12 0x0 0x0 0x0 0x1 0x1 0x1 0x13 0x0 0x0 0x0 0x1 0x1 0x1 0x14 0x0 0x0 0x0 0x1 0x1 0x1 0x15 0x5 0x0 0x0 0x1 0x0 0x0 0x16 0x5 0x0 0x0 0x1 0x0 0x0 0x17 0x0 0x1 0x0 0x0 0x0 0x0 0x18 0x5 0x0 0x0 0x1 0x0 0x0 0x19 0x2 0x0 0x0 0x1 0x1 0x0 0x1a 0x2 0x0 0x0 0x1 0x0 0x0 0x1b 0x2 0x1 0x0 0x0 0x0 0x0 0x1c 0x2 0x0 0x0 0x1 0x0 0x0 0x1d 0x0 0x1 0x0 0x0 0x0 0x0 0x1e 0x0 0x1 0x0 0x0 0x0 0x0 0x1f 0x0 0x1 0x0 0x1 0x0 0x0 0x20 0x1 0x0 0x0 0x1 0x0 0x0 0x21 0x1 0x1 0x0 0x0 0x0 0x0 0x22 0x1 0x1 0x0 0x0 0x0 0x0 0x23 0x1 0x1 0x0 0x0 0x0 0x0 0x24 0x2 0x1 0x0 0x0 0x0 0x0 0x25 0x2 0x1 0x0 0x0 0x0 0x0 0x26 0x2 0x1 0x0 0x0 0x0 0x0 0x27 0x0 0x0 0x0 0x1 0x1 0x1 0x28 0x2 0x0 0x0 0x1 0x0 0x0 0x29 0x0 0x0 0x0 0x1 0x1 0x1 0x2a 0x0 0x0 0x0 0x1 0x1 0x1 0x2b 0x1 0x1 0x0 0x0 0x0 0x0 0x2c 0x1 0x0 0x0 0x1 0x0 0x0 0x2d 0x0 0x1 0x0 0x0 0x0 0x0 0x2e 0x1 0x0 0x0 0x1 0x1 0x0 0x2f 0x1 0x0 0x0 0x1 0x1 0x0 0x30 0x1 0x0 0x0 0x1 0x1 0x1 0x31 0x1 0x0 0x0 0x1 0x1 0x1 0x32 0x1 0x0 0x0 0x1 0x1 0x1 0x33 0x1 0x0 0x0 0x1 0x1 0x1 0x34 0x1 0x0 0x0 0x1 0x0 0x0 0x35 0x1 0x0 0x0 0x1 0x0 0x0 0x36 0x1 0x0 0x0 0x1 0x0 0x0 0x37 0x1 0x0 0x0 0x1 0x0 0x0 0x38 0x1 0x0 0x0 0x1 0x0 0x0 0x39 0x1 0x0 0x0 0x1 0x0 0x0 0x3a 0x0 0x0 0x0 0x1 0x0 0x0 0x3b 0x1 0x0 0x0 0x1 0x0 0x0 0x3c 0x1 0x0 0x0 0x1 0x0 0x0 0x3d 0x1 0x0 0x0 0x1 0x0 0x0 0x3e 0x1 0x0 0x0 0x1 0x0 0x0 0x3f 0x1 0x0 0x0 0x1 0x0 0x0 0x40 0x1 0x0 0x0 0x1 0x0 0x0 0x41 0x1 0x0 0x0 0x1 0x0 0x0 0x42 0x1 0x0 0x0 0x1 0x0 0x0 0x43 0x1 0x0 0x0 0x1 0x0 0x0 0x44 0x1 0x0 0x0 0x1 0x0 0x0 0x45 0x1 0x0 0x0 0x1 0x0 0x0 0x46 0x1 0x0 0x0 0x1 0x0 0x0 0x47 0x1 0x0 0x0 0x1 0x0 0x0 0x48 0x1 0x0 0x0 0x1 0x0 0x0 0x49 0x1 0x0 0x0 0x1 0x0 0x0 0x4a 0x1 0x0 0x0 0x1 0x0 0x0 0x4b 0x0 0x0 0x0 0x0 0x0 0x1 0x4c 0x1 0x0 0x0 0x1 0x0 0x0 0x4d 0x1 0x0 0x0 0x1 0x0 0x0 0x4e 0x1 0x0 0x0 0x1 0x0 0x0 0x4f 0x0 0x0 0x0 0x0 0x0 0x0 0x50 0x0 0x0 0x0 0x0 0x0 0x0 0x51 0x2 0x0 0x0 0x1 0x1 0x1 0x52 0x1 0x0 0x0 0x1 0x1 0x1 0x53 0x1 0x0 0x0 0x1 0x1 0x1 0x54 0x2 0x0 0x0 0x1 0x1 0x1 0x55 0x2 0x0 0x0 0x1 0x0 0x0 0x56 0x2 0x1 0x0 0x0 0x0 0x0 0x57 0x2 0x1 0x0 0x0 0x0 0x0 0x58 0x2 0x1 0x0 0x0 0x0 0x0 0x59 0x1 0x0 0x0 0x1 0x1 0x1 0x5a 0x1 0x0 0x0 0x1 0x1 0x1 0x5b 0x0 0x0 0x0 0x0 0x0 0x0 0x5c 0x0 0x1 0x1 0x0 0x0 0x0 0x5d 0x1 0x0 0x0 0x1 0x1 0x0 0x5e 0x0 0x1 0x0 0x0 0x0 0x0 0x5f 0x1 0x0 0x0 0x1 0x1 0x0 0x60 0x1 0x1 0x0 0x0 0x0 0x0 0x61 0x0 0x1 0x0 0x0 0x0 0x0 0x62 0x0 0x1 0x0 0x0 0x0 0x0 0x63 0x1 0x1 0x0 0x0 0x0 0x0 0x64 0x1 0x1 0x0 0x0 0x0 0x0 0x65 0x0 0x1 0x0 0x0 0x0 0x0 0x66 0x0 0x1 0x0 0x0 0x0 0x0 0x67 0x1 0x0 0x0 0x1 0x1 0x1 0x68 0x1 0x0 0x0 0x1 0x1 0x1 0x69 0x1 0x0 0x0 0x1 0x1 0x1 0x6a 0x1 0x0 0x0 0x1 0x1 0x1 0x6b 0x0 0x1 0x0 0x0 0x0 0x0 0x6c 0x1 0x1 0x0 0x0 0x0 0x0 0x6d 0x0 0x1 0x0 0x0 0x0 0x0 0x6e 0x0 0x1 0x0 0x0 0x0 0x0 0x6f 0x1 0x1 0x0 0x0 0x0 0x0 0x70 0x0 0x0 0x0 0x0 0x0 0x0 0x71 0x0 0x0 0x0 0x1 0x0 0x0 0x72 0x0 0x0 0x0 0x1 0x0 0x0 0x73 0x0 0x0 0x0 0x1 0x0 0x0 0x74 0x0 0x0 0x0 0x1 0x0 0x0 0x75 0x0 0x0 0x0 0x1 0x0 0x0 0x76 0x0 0x0 0x0 0x1 0x0 0x0 0x77 0x0 0x0 0x0 0x1 0x0 0x0 0x78 0x0 0x0 0x0 0x1 0x0 0x0 0x79 0x0 0x0 0x0 0x1 0x0 0x0 0x86 0x1 0x0 0x0 0x1 0x0 0x1 0x87 0x1 0x1 0x0 0x0 0x0 0x0 0x88 0x1 0x1 0x0 0x0 0x0 0x0 0x89 0x1 0x1 0x0 0x0 0x0 0x0 0x8a 0x1 0x1 0x0 0x0 0x0 0x0 0x8b 0x1 0x1 0x0 0x0 0x0 0x0 0x8c 0x1 0x0 0x0 0x1 0x0 0x0 0x8d 0x1 0x0 0x0 0x1 0x0 0x0 0x8e 0x1 0x0 0x0 0x1 0x0 0x0 0x8f 0x1 0x0 0x0 0x1 0x0 0x0 0x90 0x1 0x0 0x0 0x1 0x0 0x0 0x91 0x1 0x1 0x0 0x0 0x0 0x0 0x92 0x1 0x1 0x0 0x0 0x0 0x0 0x93 0x1 0x1 0x0 0x0 0x0 0x0 0x94 0x1 0x1 0x0 0x0 0x0 0x0 0x95 0x1 0x1 0x0 0x0 0x0 0x0 0x96 0x4 0x0 0x0 0x1 0x1 0x0 0x97 0x4 0x1 0x0 0x0 0x0 0x0 0x98 0x5 0x0 0x0 0x0 0x0 0x0 0x99 0x5 0x1 0x0 0x0 0x0 0x0 0x9a 0x1 0x1 0x0 0x0 0x0 0x0 0x9b 0x1 0x0 0x0 0x1 0x1 0x0 0x9c 0x1 0x1 0x0 0x0 0x0 0x0 0x9d 0x1 0x1 0x0 0x0 0x0 0x0 0x9e 0x0 0x1 0x0 0x0 0x0 0x0 0x9f 0x0 0x1 0x0 0x0 0x0 0x0 0xa0 0x0 0x1 0x1 0x1 0x0 0x0 0xa1 0x1 0x0 0x0 0x1 0x1 0x1 0xa2 0x1 0x0 0x0 0x1 0x1 0x1 0xa3 0x1 0x0 0x0 0x1 0x1 0x1 0xa4 0x1 0x0 0x0 0x1 0x1 0x1 0xa5 0x0 0x1 0x0 0x1 0x0 0x1 0xa6 0x0 0x1 0x0 0x0 0x0 0x0 0xa7 0x1 0x0 0x0 0x1 0x0 0x0 0xa8 0x1 0x0 0x0 0x1 0x0 0x0 0xa9 0x0 0x1 0x0 0x1 0x0 0x1 0xaa 0x1 0x0 0x0 0x1 0x1 0x1 0xab 0x1 0x1 0x0 0x0 0x0 0x1 0xac 0x1 0x1 0x0 0x0 0x0 0x0 0xad 0x1 0x1 0x0 0x0 0x0 0x0 0xae 0x1 0x0 0x0 0x1 0x1 0x0 0xaf 0x1 0x0 0x0 0x1 0x1 0x1 0xb0 0x1 0x0 0x0 0x1 0x1 0x1 0xb2 0x0 0x0 0x0 0x0 0x0 0x0 0xb3 0x0 0x1 0x0 0x0 0x0 0x0 0xb4 0x0 0x0 0x0 0x1 0x0 0x0 0xb5 0x0 0x0 0x0 0x1 0x0 0x0 0xb6 0x0 0x0 0x0 0x1 0x0 0x0 0xb7 0x0 0x0 0x0 0x1 0x0 0x0 0xb8 0x0 0x0 0x0 0x1 0x0 0x0 0xb9 0x0 0x0 0x0 0x1 0x0 0x0 0xba 0x0 0x0 0x0 0x1 0x0 0x0>;
		};
	};

	fragment@42 {
		target = <0xffffffff>;

		__overlay__ {
			interrupt-parent = <0xffffffff>;
			interrupts = <0x1 0x2 0x1 0x0>;
			status = "okay";
		};
	};

	fragment@43 {
		target = <0xffffffff>;

		__overlay__ {
			interrupt-parent = <0xffffffff>;
			interrupts = <0x3 0x2 0x3 0x0>;
			status = "okay";
		};
	};

	fragment@44 {
		target = <0xffffffff>;

		__overlay__ {
			interrupt-parent = <0xffffffff>;
			interrupts = <0x8 0x8 0x0>;
			status = "okay";
		};
	};

	fragment@45 {
		target = <0xffffffff>;

		__overlay__ {
			interrupt-parent = <0xffffffff>;
			interrupts = <0x9 0x1 0x9 0x0>;
			status = "okay";
		};
	};

	fragment@46 {
		target = <0xffffffff>;

		__overlay__ {
			interrupt-parent = <0xffffffff>;
			interrupts = <0x14 0x2 0x14 0x0>;
			status = "okay";
		};
	};

	fragment@47 {
		target = <0xffffffff>;

		__overlay__ {
			interrupt-parent = <0xffffffff>;
			interrupts = <0x27 0x8 0x27 0x0>;
			status = "okay";
		};
	};

	fragment@48 {
		target = <0xffffffff>;

		__overlay__ {
			interrupt-parent = <0xffffffff>;
			interrupts = <0x29 0x2 0x29 0x0>;
			status = "okay";
		};
	};

	fragment@49 {
		target = <0xffffffff>;

		__overlay__ {
			interrupt-parent = <0xffffffff>;
			interrupts = <0x2a 0x2 0x2a 0x0>;
			status = "okay";
		};
	};

	fragment@5 {
		target = <0xffffffff>;

		__overlay__ {

			fpsensor_fp_power_high {
				phandle = <0xc>;

				pins_cmd_dat {
					output-high;
					pinmux = <0xa000>;
					slew-rate = <0x1>;
				};
			};

			fpsensor_fpc_rst_high {
				phandle = <0xb>;

				pins_cmd_dat {
					output-high;
					pinmux = <0x1f00>;
					slew-rate = <0x1>;
				};
			};

			fpsensor_fpc_rst_low {
				phandle = <0xa>;

				pins_cmd_dat {
					output-low;
					pinmux = <0x1f00>;
					slew-rate = <0x1>;
				};
			};
		};
	};

	fragment@50 {
		target = <0xffffffff>;

		__overlay__ {
			interrupt-parent = <0xffffffff>;
			interrupts = <0x2c 0x1 0x2c 0x1>;
			status = "okay";
		};
	};

	fragment@51 {
		target = <0xffffffff>;

		__overlay__ {
			deb-gpios = <0xffffffff 0x4b 0x0>;
			debounce = <0x0>;
			interrupt-parent = <0xffffffff>;
			interrupts = <0x4b 0x4 0x4b 0x0>;
			status = "okay";
		};
	};

	fragment@52 {
		target = <0xffffffff>;

		__overlay__ {
			interrupt-parent = <0xffffffff>;
			interrupts = <0x90 0x4 0xb4 0x0>;
			status = "okay";
		};
	};

	fragment@53 {
		target = <0xffffffff>;

		__overlay__ {
			compatible = "mediatek,md1_sim1_hot_plug_eint-eint";
			debounce = <0x0 0x2710>;
			dedicated = <0x0 0x0>;
			interrupts = <0x0 0x8>;
			sockettype = <0x0 0x0>;
			src_pin = <0x0 0x1>;
			status = "okay";
		};
	};

	fragment@54 {
		target = <0xffffffff>;

		__overlay__ {
			compatible = "mediatek,md1_sim2_hot_plug_eint-eint";
			debounce = <0x1 0x2710>;
			dedicated = <0x1 0x0>;
			interrupts = <0x1 0x8>;
			sockettype = <0x1 0x0>;
			src_pin = <0x1 0x2>;
			status = "okay";
		};
	};

	fragment@55 {
		target = <0xffffffff>;

		__overlay__ {
			regulator-default-on = <0x1>;
			regulator-name = "vcama1";
			status = "okay";
		};
	};

	fragment@56 {
		target = <0xffffffff>;

		__overlay__ {
			regulator-default-on = <0x1>;
			regulator-name = "vcama2";
			status = "okay";
		};
	};

	fragment@57 {
		target = <0xffffffff>;

		__overlay__ {
			regulator-default-on = <0x1>;
			regulator-name = "vsim1";
			status = "okay";
		};
	};

	fragment@58 {
		target = <0xffffffff>;

		__overlay__ {
			regulator-default-on = <0x1>;
			regulator-name = "vsim2";
			status = "okay";
		};
	};

	fragment@59 {
		target = <0xffffffff>;

		__overlay__ {
			regulator-default-on = <0x1>;
			regulator-name = "vcamd";
			status = "okay";
		};
	};

	fragment@6 {
		target = <0xffffffff>;

		__overlay__ {
			debounce = <0x8 0x0>;
			int_fpgpio = <0xffffffff 0x8 0x0>;
			pinctrl-0 = <0xd>;
			pinctrl-1 = <0xe>;
			pinctrl-10 = <0x17>;
			pinctrl-11 = <0x18>;
			pinctrl-12 = <0x19>;
			pinctrl-13 = <0x1a>;
			pinctrl-14 = <0x1b>;
			pinctrl-15 = <0x1c>;
			pinctrl-16 = <0x1d>;
			pinctrl-17 = <0x1e>;
			pinctrl-2 = <0xf>;
			pinctrl-3 = <0x10>;
			pinctrl-4 = <0x11>;
			pinctrl-5 = <0x12>;
			pinctrl-6 = <0x13>;
			pinctrl-7 = <0x14>;
			pinctrl-8 = <0x15>;
			pinctrl-9 = <0x16>;
			pinctrl-names = "fpsensor_spi_default", "fpsensor_spi_cs_low", "fpsensor_spi_cs_high", "fpsensor_spi_mi_low", "fpsensor_spi_mi_high", "fpsensor_spi_mo_low", "fpsensor_spi_mo_high", "fpsensor_spi_mclk_low", "fpsensor_spi_mclk_high", "fpsensor_finger_rst_low", "fpsensor_finger_rst_high", "fpsensor_finger_power_low", "fpsensor_finger_power_high", "fpsensor_eint", "fpsensor_eint_in_low", "fpsensor_eint_in_float", "fpsensor_finger_cs_low", "fpsensor_finger_cs_high";
			status = "okay";
		};
	};

	fragment@60 {
		target = <0xffffffff>;

		__overlay__ {
			regulator-default-on = <0x1>;
			regulator-name = "vcamio";
			status = "okay";
		};
	};

	fragment@61 {
		target = <0xffffffff>;

		__overlay__ {
			regulator-default-on = <0x1>;
			regulator-name = "vldo28";
			status = "okay";
		};
	};

	fragment@62 {
		target = <0xffffffff>;

		__overlay__ {
			status = "okay";
			vcama-supply = <0xffffffff>;
			vcama_sub-supply = <0xffffffff>;
			vcamaf-supply = <0xffffffff>;
			vcamd_main2-supply = <0xffffffff>;
			vcamio-supply = <0xffffffff>;
			vcamio_main2-supply = <0xffffffff>;
			vcamio_sub-supply = <0xffffffff>;
		};
	};

	fragment@63 {
		target = <0xffffffff>;

		__overlay__ {
			status = "okay";
		};
	};

	fragment@64 {
		target = <0xffffffff>;

		__overlay__ {
			mediatek,kpd-hw-dl-key0 = <0x11>;
			mediatek,kpd-hw-dl-key1 = <0x0>;
			mediatek,kpd-hw-dl-key2 = <0x8>;
			mediatek,kpd-hw-factory-key = <0x0>;
			mediatek,kpd-hw-init-map = <0x72 0x0 0x0 0x0 0x0 0x0 0x0 0x0 0x0 0x0 0x0 0x0 0x0 0x0 0x0 0x0 0x0 0x0 0x0 0x0 0x0 0x0 0x0 0x0 0x0 0x0 0x0 0x0 0x0 0x0 0x0 0x0 0x0 0x0 0x0 0x0 0x0 0x0 0x0 0x0 0x0 0x0 0x0 0x0 0x0 0x0 0x0 0x0 0x0 0x0 0x0 0x0 0x0 0x0 0x0 0x0 0x0 0x0 0x0 0x0 0x0 0x0 0x0 0x0 0x0 0x0 0x0 0x0 0x0 0x0 0x0 0x0>;
			mediatek,kpd-hw-map-num = <0x48>;
			mediatek,kpd-hw-pwrkey = <0x8>;
			mediatek,kpd-hw-recovery-key = <0x11>;
			mediatek,kpd-hw-rstkey = <0x11>;
			mediatek,kpd-key-debounce = <0x400>;
			mediatek,kpd-pwkey-gpio-din = <0x0>;
			mediatek,kpd-pwrkey-eint-gpio = <0x0>;
			mediatek,kpd-sw-pwrkey = <0x74>;
			mediatek,kpd-sw-rstkey = <0x73>;
			mediatek,kpd-use-extend-type = <0x0>;
			status = "okay";
		};
	};

	fragment@65 {
		target = <0xffffffff>;

		__overlay__ {

			camdefault {
				phandle = <0x2b>;
			};

			camera0_mclk_2mA@gpio100 {
				phandle = <0x37>;

				pins_cmd_dat {
					drive-strength = <0x2>;
					pinmux = <0x6401>;
				};
			};

			camera0_mclk_4mA@gpio100 {
				phandle = <0x38>;

				pins_cmd_dat {
					drive-strength = <0x4>;
					pinmux = <0x6401>;
				};
			};

			camera0_mclk_6mA@gpio100 {
				phandle = <0x39>;

				pins_cmd_dat {
					drive-strength = <0x6>;
					pinmux = <0x6401>;
				};
			};

			camera0_mclk_8mA@gpio100 {
				phandle = <0x3a>;

				pins_cmd_dat {
					drive-strength = <0x7>;
					pinmux = <0x6401>;
				};
			};

			camera0_mclk_gpio_mode@gpio100 {
				phandle = <0x36>;

				pins_cmd_dat {
					drive-strength = <0x4>;
					pinmux = <0x6400>;
				};
			};

			camera0_rst_output_high@gpio102 {
				phandle = <0x2d>;

				pins_cmd_dat {
					output-high;
					pinmux = <0x6600>;
				};
			};

			camera0_rst_output_low@gpio102 {
				phandle = <0x2c>;

				pins_cmd_dat {
					output-low;
					pinmux = <0x6600>;
				};
			};

			camera1_mclk_2mA@gpio108 {
				phandle = <0x3c>;

				pins_cmd_dat {
					drive-strength = <0x2>;
					pinmux = <0x6c01>;
				};
			};

			camera1_mclk_4mA@gpio108 {
				phandle = <0x3d>;

				pins_cmd_dat {
					drive-strength = <0x4>;
					pinmux = <0x6c01>;
				};
			};

			camera1_mclk_6mA@gpio108 {
				phandle = <0x3e>;

				pins_cmd_dat {
					drive-strength = <0x6>;
					pinmux = <0x6c01>;
				};
			};

			camera1_mclk_8mA@gpio108 {
				phandle = <0x3f>;

				pins_cmd_dat {
					drive-strength = <0x7>;
					pinmux = <0x6c01>;
				};
			};

			camera1_mclk_gpio_mode@gpio108 {
				phandle = <0x3b>;

				pins_cmd_dat {
					drive-strength = <0x4>;
					pinmux = <0x6c00>;
				};
			};

			camera1_rst_output_high@gpio109 {
				phandle = <0x2f>;

				pins_cmd_dat {
					output-high;
					pinmux = <0x6d00>;
				};
			};

			camera1_rst_output_low@gpio109 {
				phandle = <0x2e>;

				pins_cmd_dat {
					output-low;
					pinmux = <0x6d00>;
				};
			};

			camera1_vcamd_output_high@gpio158 {
				phandle = <0x34>;

				pins_cmd_dat {
					output-high;
					pinmux = <0x9e00>;
				};
			};

			camera1_vcamd_output_low@gpio158 {
				phandle = <0x35>;

				pins_cmd_dat {
					output-low;
					pinmux = <0x9e00>;
				};
			};

			camera2_mclk_2mA@gpio111 {
				phandle = <0x5d>;

				pins_cmd_dat {
					drive-strength = <0x2>;
					pinmux = <0x6f01>;
				};
			};

			camera2_mclk_4mA@gpio111 {
				phandle = <0x5e>;

				pins_cmd_dat {
					drive-strength = <0x4>;
					pinmux = <0x6f01>;
				};
			};

			camera2_mclk_6mA@gpio111 {
				phandle = <0x5f>;

				pins_cmd_dat {
					drive-strength = <0x6>;
					pinmux = <0x6f01>;
				};
			};

			camera2_mclk_8mA@gpio111 {
				phandle = <0x60>;

				pins_cmd_dat {
					drive-strength = <0x7>;
					pinmux = <0x6f01>;
				};
			};

			camera2_mclk_gpio_off@gpio111 {
				phandle = <0x40>;

				pins_cmd_dat {
					output-low;
					pinmux = <0x6f00>;
				};
			};

			camera2_mclk_gpio_on@gpio111 {
				phandle = <0x41>;

				pins_cmd_dat {
					drive-strength = <0x6>;
					pinmux = <0x6f01>;
				};
			};

			camera2_pdn_output_high@gpio110 {
				phandle = <0x33>;

				pins_cmd_dat {
					output-high;
					pinmux = <0x6e00>;
				};
			};

			camera2_pdn_output_low@gpio110 {
				phandle = <0x32>;

				pins_cmd_dat {
					output-low;
					pinmux = <0x6e00>;
				};
			};

			camera2_rst_output_high@gpio112 {
				phandle = <0x31>;

				pins_cmd_dat {
					output-high;
					pinmux = <0x7000>;
				};
			};

			camera2_rst_output_low@gpio112 {
				phandle = <0x30>;

				pins_cmd_dat {
					output-low;
					pinmux = <0x7000>;
				};
			};
		};
	};

	fragment@66 {
		target = <0xffffffff>;

		__overlay__ {

			camera_eeprom0@50 {
				compatible = "mediatek,camera_eeprom";
				phandle = <0x61>;
				reg = <0x50>;
				status = "okay";
			};
		};
	};

	fragment@67 {
		target = <0xffffffff>;

		__overlay__ {
			cam0_enable_sensor = "s5kjns_acc_main_mipi_raw s5kjns_sunny_main_mipi_raw s5kjns_ofilm_main_mipi_raw s5kjn1_acc_main_mipi_raw";
			cam0_vcama-supply = <0xffffffff>;
			cam0_vcamaf-supply = <0xffffffff>;
			cam0_vcamd-supply = <0xffffffff>;
			cam0_vcamio-supply = <0xffffffff>;
			cam1_enable_sensor = "s5k5e9_sunny_front_mipi_raw hi556_ofilm_front_mipi_raw sc500cs_truly_front_mipi_raw";
			cam1_vcama-supply = <0xffffffff>;
			cam1_vcamio-supply = <0xffffffff>;
			cam2_vcama-supply = <0xffffffff>;
			cam2_vcamio-supply = <0xffffffff>;
			pinctrl-0 = <0x2b>;
			pinctrl-1 = <0x2c>;
			pinctrl-10 = <0x35>;
			pinctrl-11 = <0x36>;
			pinctrl-12 = <0x37>;
			pinctrl-13 = <0x38>;
			pinctrl-14 = <0x39>;
			pinctrl-15 = <0x3a>;
			pinctrl-16 = <0x3b>;
			pinctrl-17 = <0x3c>;
			pinctrl-18 = <0x3d>;
			pinctrl-19 = <0x3e>;
			pinctrl-2 = <0x2d>;
			pinctrl-20 = <0x3f>;
			pinctrl-3 = <0x2e>;
			pinctrl-4 = <0x2f>;
			pinctrl-5 = <0x30>;
			pinctrl-6 = <0x31>;
			pinctrl-7 = <0x32>;
			pinctrl-8 = <0x33>;
			pinctrl-9 = <0x34>;
			pinctrl-names = "default", "cam0_rst0", "cam0_rst1", "cam1_rst0", "cam1_rst1", "cam2_rst0", "cam2_rst1", "cam2_pnd0", "cam2_pnd1", "cam1_vcamd_on", "cam1_vcamd_off", "cam0_mclk_off", "cam0_mclk_2mA", "cam0_mclk_4mA", "cam0_mclk_6mA", "cam0_mclk_8mA", "cam1_mclk_off", "cam1_mclk_2mA", "cam1_mclk_4mA", "cam1_mclk_6mA", "cam1_mclk_8mA";
			status = "okay";
		};
	};

	fragment@68 {
		target = <0xffffffff>;

		__overlay__ {

			bf30a2_yuv@6e {
				compatible = "byd,bf30a2_yuv";
				pinctrl-0 = <0x2b>;
				pinctrl-1 = <0x40>;
				pinctrl-2 = <0x41>;
				pinctrl-names = "default", "bf30a2_mclk_off", "bf30a2_mclk_on";
				reg = <0x6e>;
				status = "okay";
				vcama-supply = <0xffffffff>;
				vcamio-supply = <0xffffffff>;
			};

			gc6133c_yuv@40 {
				compatible = "gc,gc6133c_yuv";
				pinctrl-0 = <0x2b>;
				pinctrl-1 = <0x40>;
				pinctrl-2 = <0x41>;
				pinctrl-names = "default", "gc6133c_mclk_off", "gc6133c_mclk_on";
				reg = <0x40>;
				status = "okay";
				vcama-supply = <0xffffffff>;
				vcamio-supply = <0xffffffff>;
			};
		};
	};

	fragment@69 {
		target = <0xffffffff>;

		__overlay__ {

			bf30a2_yuv_i2c4@6e {
				compatible = "byd,bf30a2_yuv_i2c4";
				pinctrl-0 = <0x2b>;
				pinctrl-1 = <0x40>;
				pinctrl-2 = <0x41>;
				pinctrl-names = "default", "bf30a2_mclk_off", "bf30a2_mclk_on";
				reg = <0x6e>;
				status = "okay";
				vcama-supply = <0xffffffff>;
				vcamio-supply = <0xffffffff>;
			};

			gc6133c_yuv_i2c4@40 {
				compatible = "gc,gc6133c_yuv_i2c4";
				pinctrl-0 = <0x2b>;
				pinctrl-1 = <0x40>;
				pinctrl-2 = <0x41>;
				pinctrl-names = "default", "gc6133c_mclk_off", "gc6133c_mclk_on";
				reg = <0x40>;
				status = "okay";
				vcama-supply = <0xffffffff>;
				vcamio-supply = <0xffffffff>;
			};
		};
	};

	fragment@7 {
		target = <0xffffffff>;

		__overlay__ {

			fpsensor_eint_as_int {
				phandle = <0x1a>;

				pins_cmd_dat {
					bias-disable;
					pinmux = <0x800>;
					slew-rate = <0x0>;
				};
			};

			fpsensor_eint_in_float {
				phandle = <0x1c>;

				pins_cmd_dat {
					bias-disable;
					pinmux = <0x800>;
					slew-rate = <0x0>;
				};
			};

			fpsensor_eint_in_low {
				phandle = <0x1b>;

				pins_cmd_dat {
					bias-pull-down = <0x0>;
					pinmux = <0x800>;
					slew-rate = <0x0>;
				};
			};

			fpsensor_finger_cs_high {
				phandle = <0x1e>;

				pins_cmd_dat {
					output-high;
					pinmux = <0x1902>;
					slew-rate = <0x1>;
				};
			};

			fpsensor_finger_cs_low {
				phandle = <0x1d>;

				pins_cmd_dat {
					output-low;
					pinmux = <0x1902>;
					slew-rate = <0x1>;
				};
			};

			fpsensor_finger_power_high {
				phandle = <0x19>;

				pins_cmd_dat {
					output-high;
					pinmux = <0xa000>;
					slew-rate = <0x1>;
				};
			};

			fpsensor_finger_power_low {
				phandle = <0x18>;

				pins_cmd_dat {
					output-low;
					pinmux = <0xa000>;
					slew-rate = <0x1>;
				};
			};

			fpsensor_finger_rst_high {
				phandle = <0x17>;

				pins_cmd_dat {
					output-high;
					pinmux = <0x1f00>;
					slew-rate = <0x1>;
				};
			};

			fpsensor_finger_rst_low {
				phandle = <0x16>;

				pins_cmd_dat {
					output-low;
					pinmux = <0x1f00>;
					slew-rate = <0x1>;
				};
			};

			fpsensor_spi_cs_high {
				phandle = <0xf>;

				pins_cmd_dat {
					output-high;
					pinmux = <0x1902>;
					slew-rate = <0x1>;
				};
			};

			fpsensor_spi_cs_low {
				phandle = <0xe>;

				pins_cmd_dat {
					output-low;
					pinmux = <0x1902>;
					slew-rate = <0x1>;
				};
			};

			fpsensor_spi_default {
				phandle = <0xd>;
			};

			fpsensor_spi_mclk_high {
				phandle = <0x15>;

				pins_cmd_dat {
					output-high;
					pinmux = <0x1b02>;
					slew-rate = <0x1>;
				};
			};

			fpsensor_spi_mclk_low {
				phandle = <0x14>;

				pins_cmd_dat {
					output-low;
					pinmux = <0x1b02>;
					slew-rate = <0x1>;
				};
			};

			fpsensor_spi_mi_high {
				phandle = <0x11>;

				pins_cmd_dat {
					bias-disable;
					pinmux = <0x1c02>;
				};
			};

			fpsensor_spi_mi_low {
				phandle = <0x10>;

				pins_cmd_dat {
					bias-pull-up = <0x0>;
					pinmux = <0x1c02>;
					slew-rate = <0x0>;
				};
			};

			fpsensor_spi_mo_high {
				phandle = <0x13>;

				pins_cmd_dat {
					output-high;
					pinmux = <0x1a02>;
					slew-rate = <0x1>;
				};
			};

			fpsensor_spi_mo_low {
				phandle = <0x12>;

				pins_cmd_dat {
					output-low;
					pinmux = <0x1a02>;
					slew-rate = <0x1>;
				};
			};
		};
	};

	fragment@70 {
		target = <0xffffffff>;

		__overlay__ {
			pinctrl-0 = <0x42>;
			pinctrl-1 = <0x43>;
			pinctrl-2 = <0x44>;
			pinctrl-names = "default", "hwen_high", "hwen_low";
			status = "okay";
		};
	};

	fragment@71 {
		target = <0xffffffff>;

		__overlay__ {

			flashlightdefault {
				phandle = <0x42>;
			};

			flashlightenoutput0 {
				phandle = <0x44>;

				pins_cmd_dat {
					output-low;
					pinmux = <0x9800>;
					slew-rate = <0x1>;
				};
			};

			flashlightenoutput1 {
				phandle = <0x43>;

				pins_cmd_dat {
					output-high;
					pinmux = <0x9800>;
					slew-rate = <0x1>;
				};
			};
		};
	};

	fragment@72 {
		target = <0xffffffff>;

		__overlay__ {
			status = "ok";

			novatek@0 {
				chipone,irq-gpio = <0xffffffff 0x1 0x2001>;
				chipone,rst-gpio = <0xffffffff 0x5c 0x0>;
				chipone,touch-charger-detect-enable;
				chipone,touch-charger-detect-psp = "POWER_SUPPLY_PROP_ONLINE";
				chipone,touch-charger-detect-psp-poll-interval = <0x3e8>;
				chipone,touch-charger-detect-psy-name = "charger";
				chipone,touch-charger-detect-type = "notify";
				chipone,touch-earjack-detect-enable;
				chipone,touch-earjack-poll-interval = <0x3e8>;
				chipone,touch-earjack-state-filepath = "/sys/bus/platform/drivers/Accdet_Driver/state";
				chipone,x-res = <0x2cf>;
				chipone,y-res = <0x671>;
				compatible = "novatek,NVT-ts-spi", "focaltech,fts", "chipone-tddi";
				focaltech,display-coords = <0x0 0x0 0x2cf 0x671>;
				focaltech,irq-gpio = <0xffffffff 0x1 0x2001>;
				focaltech,max-touch-number = <0xa>;
				focaltech,reset-gpio = <0xffffffff 0x5c 0x0>;
				novatek,irq-gpio = <0xffffffff 0x1 0x2001>;
				novatek,mp-support-dt;
				novatek,reset-gpio = <0xffffffff 0x5c 0x0>;
				novatek,spi-rd-fast-addr = <0x3f310>;
				novatek,swrst-n8-addr = <0x3f0fe>;
				reg = <0x0>;
				spi-max-frequency = <0x927c00>;
				status = "ok";

				novatek-mp-criteria-5970@0 {
					#address-cells = <0x1>;
					#size-cells = <0x0>;
					AIN_KEY = <0x0 0x1 0x2 0xff>;
					AIN_X = <0x0 0x1 0x2 0x3 0x4 0x5 0x6 0x7 0x8 0x9 0xa 0xb 0xc 0xd 0xe 0xf 0x10 0x11>;
					AIN_Y = <0x0 0x1 0x2 0x3 0x4 0x5 0x6 0x7 0x8 0x9 0xa 0xb 0xc 0xd 0xe 0xf 0x10 0x11 0x12 0x13 0x14 0x15 0x16 0x17 0x18 0x19 0x1a 0x1b 0x1c 0x1d 0x1e 0x1f>;
					IC_KEY_CFG_SIZE = <0x4>;
					IC_X_CFG_SIZE = <0x12>;
					IC_Y_CFG_SIZE = <0x20>;
					PS_Config_Diff_Test_Frame = <0x32>;
					PS_Config_Lmt_FW_CC_N = <0x29 0x28 0x29 0x29 0x29 0x29 0x29 0x29 0xffff0001 0xffff0001 0x2c 0x2c 0x2c 0x2b 0x2b 0x2b 0x2a 0x2a 0x2a 0x2a 0x2a 0x2a 0x2a 0x2a 0x2a 0x2a 0x2c 0x2d 0x2c 0x2c 0x2c 0x2c 0x2c 0x2c 0x2c 0x2d 0x2a 0x2a 0x2a 0x2a 0x2a 0x2a 0x2a 0x2a 0x2b 0x2c 0x2b 0x2c 0x2c 0x2b 0x2c 0x2c 0x2c 0x2c 0x2b 0x2a 0x2a 0x2b 0x2b 0x2b 0x2b 0x2b 0x2c 0x2d 0x2d 0x2d 0x2d 0x2c 0x2d 0x2d 0x2d 0x2d 0x2b 0x2a 0x2a 0x2a 0x2a 0x2a 0x2a 0x2b 0x2c 0x2d 0x2d 0x2d 0x2d 0x2c 0x2c 0x2c 0x2d 0x2d 0x2b 0x2b 0x2a 0x2b 0x2b 0x2b 0x2b 0x2b 0x2c 0x2d 0x2c 0x2c 0x2c 0x2c 0x2c 0x2c 0x2d 0x2d 0x2c 0x2b 0x2b 0x2b 0x2b 0x2b 0x2b 0x2b 0x2c 0x2d 0x2d 0x2d 0x2d 0x2c 0x2c 0x2c 0x2c 0x2c 0x2d 0x2c 0x2c 0x2c 0x2c 0x2c 0x2c 0x2c 0x2d 0x2f 0x2f 0x2f 0x2f 0x2e 0x2e 0x2d 0x2e 0x2e 0x2c 0x2b 0x2b 0x2b 0x2b 0x2a 0x2a 0x2b 0x2c 0x2e 0x2d 0x2d 0x2d 0x2d 0x2d 0x2c 0x2c 0x2d 0x2d 0x2c 0x2c 0x2c 0x2c 0x2c 0x2c 0x2c 0x2d 0x2f 0x2e 0x2e 0x2e 0x2e 0x2d 0x2d 0x2d 0x2e 0x2b 0x2a 0x2a 0x2a 0x2a 0x2a 0x2a 0x2a 0x2c 0x2d 0x2d 0x2d 0x2d 0x2c 0x2c 0x2c 0x2c 0x2d 0x2d 0x2c 0x2c 0x2c 0x2c 0x2c 0x2c 0x2c 0x2d 0x2f 0x2e 0x2f 0x2e 0x2e 0x2e 0x2d 0x2d 0x2f 0x2c 0x2a 0x2a 0x2b 0x2a 0x2a 0x2a 0x2a 0x2c 0x2e 0x2d 0x2d 0x2d 0x2d 0x2d 0x2d 0x2d 0x2d 0x2d 0x2d 0x2d 0x2d 0x2d 0x2d 0x2d 0x2d 0x2e 0x30 0x2f 0x2f 0x2f 0x2f 0x2f 0x2e 0x2e 0x2f 0x2c 0x2b 0x2b 0x2b 0x2b 0x2b 0x2b 0x2b 0x2c 0x2e 0x2d 0x2d 0x2d 0x2d 0x2d 0x2d 0x2d 0x2d 0x2d 0x2d 0x2d 0x2d 0x2d 0x2d 0x2d 0x2d 0x2e 0x30 0x2f 0x2f 0x2f 0x2f 0x2f 0x2f 0x2f 0x2f 0x2c 0x2c 0x2c 0x2c 0x2c 0x2c 0x2c 0x2c 0x2d 0x2e 0x2d 0x2d 0x2d 0x2d 0x2d 0x2d 0x2d 0x2d 0x2d 0x2d 0x2d 0x2d 0x2d 0x2d 0x2d 0x2d 0x2e 0x2f 0x2f 0x2f 0x2f 0x2f 0x2e 0x2e 0x2e 0x2f 0x2c 0x2b 0x2b 0x2b 0x2b 0x2b 0x2b 0x2b 0x2c 0x2e 0x2d 0x2d 0x2d 0x2d 0x2d 0x2d 0x2d 0x2d 0x2e 0x2d 0x2d 0x2d 0x2d 0x2d 0x2d 0x2d 0x2f 0x2f 0x2e 0x2e 0x2e 0x2e 0x2e 0x2d 0x2e 0x2f 0x2c 0x2c 0x2c 0x2c 0x2c 0x2c 0x2c 0x2c 0x2d 0x2e 0x2d 0x2d 0x2d 0x2d 0x2d 0x2d 0x2d 0x2e 0x2f 0x2e 0x2e 0x2e 0x2e 0x2e 0x2e 0x2e 0x2f 0x30 0x2f 0x2f 0x2f 0x2f 0x2f 0x2f 0x2f 0x30 0x2c 0x2c 0x2c 0x2c 0x2c 0x2c 0x2c 0x2c 0x2d 0x2f 0x2d 0x2e 0x2e 0x2d 0x2e 0x2d 0x2e 0x2f 0x2c 0x2c 0x2b 0x2c 0x2b 0x2b 0x2b 0x2c 0x2c 0x2f 0x2d 0x2e 0x2e 0x2d 0x2d 0x2d 0x2e 0x2f 0x2c 0x2c 0x2c 0x2c 0x2c 0x2c 0x2c 0x2c 0x2d 0x2f 0x2e 0x2e 0x2e 0x2d 0x2e 0x2e 0x2e 0x2f 0x2c 0x2c 0x2c 0x2c 0x2c 0x2c 0x2c 0x2c 0x2d 0x2f 0x2d 0x2d 0x2d 0x2d 0x2d 0x2d 0x2e 0x2f 0x2d 0x2c 0x2c 0x2c 0x2c 0x2c 0x2c 0x2c 0x2d 0x2f 0x2e 0x2e 0x2e 0x2e 0x2e 0x2e 0x2f 0x2f 0x2d 0x2c 0x2c 0x2c 0x2c 0x2c 0x2c 0x2c 0x2d 0x2e 0x2d 0x2d 0x2d 0x2d 0x2d 0x2d 0x2d 0x2e 0x2d 0x2c 0x2c 0x2c 0x2c 0x2c 0x2c 0x2c 0x2d 0x2f 0x2d 0x2d 0x2d 0x2d 0x2d 0x2d 0x2e 0x2f 0x2b 0x2c 0x2c 0x2c 0x2c 0x2c 0x2c 0x2c 0x2d 0x2f 0x2d 0x2d 0x2e 0x2d 0x2d 0x2d 0x2e 0x2d 0x2a 0x2c 0x2c 0x2c 0x2b 0x2b 0x2b 0x2b 0x2c 0x2f 0x2d 0x2e 0x2e 0x2d 0x2d 0x2e 0x2e 0x2d 0x2c 0x2c 0x2c 0x2c 0x2c 0x2c 0x2c 0x2c 0x2d 0x2e 0x2d 0x2d 0x2d 0x2d 0x2d 0x2d 0x2d 0x2d 0x0 0x0 0x0>;
					PS_Config_Lmt_FW_CC_P = <0x5c 0x5b 0x5c 0x5c 0x5c 0x5c 0x5c 0x5c 0xffff 0xffff 0x61 0x61 0x61 0x60 0x60 0x60 0x5f 0x5f 0x5f 0x5f 0x5f 0x5f 0x5f 0x5f 0x5f 0x5f 0x61 0x64 0x63 0x63 0x63 0x63 0x63 0x63 0x63 0x64 0x5f 0x5d 0x5d 0x5d 0x5d 0x5d 0x5d 0x5d 0x60 0x63 0x60 0x61 0x61 0x60 0x61 0x61 0x61 0x63 0x60 0x5f 0x5f 0x60 0x60 0x60 0x60 0x60 0x63 0x66 0x64 0x64 0x64 0x63 0x64 0x64 0x64 0x66 0x60 0x5f 0x5f 0x5f 0x5f 0x5f 0x5f 0x60 0x63 0x66 0x64 0x64 0x64 0x63 0x63 0x63 0x64 0x64 0x60 0x60 0x5f 0x60 0x60 0x60 0x60 0x60 0x63 0x66 0x63 0x63 0x63 0x63 0x63 0x63 0x64 0x66 0x61 0x60 0x60 0x60 0x60 0x60 0x60 0x60 0x63 0x66 0x64 0x64 0x64 0x63 0x63 0x63 0x63 0x63 0x64 0x63 0x63 0x63 0x63 0x63 0x63 0x63 0x66 0x6a 0x68 0x68 0x68 0x67 0x67 0x66 0x67 0x67 0x61 0x60 0x60 0x60 0x60 0x5f 0x5f 0x60 0x61 0x67 0x64 0x64 0x64 0x64 0x64 0x63 0x63 0x64 0x64 0x63 0x63 0x63 0x63 0x63 0x63 0x63 0x66 0x6a 0x67 0x67 0x67 0x67 0x66 0x66 0x66 0x67 0x60 0x5f 0x5f 0x5f 0x5f 0x5f 0x5f 0x5f 0x61 0x66 0x64 0x64 0x64 0x63 0x63 0x63 0x63 0x64 0x64 0x61 0x61 0x61 0x61 0x61 0x61 0x61 0x64 0x6a 0x67 0x68 0x67 0x67 0x67 0x66 0x66 0x68 0x61 0x5f 0x5f 0x60 0x5f 0x5f 0x5f 0x5f 0x61 0x67 0x66 0x66 0x66 0x66 0x64 0x64 0x64 0x66 0x66 0x66 0x66 0x66 0x66 0x64 0x66 0x66 0x67 0x6b 0x68 0x68 0x68 0x68 0x68 0x67 0x67 0x68 0x61 0x60 0x60 0x60 0x60 0x60 0x60 0x60 0x63 0x67 0x66 0x66 0x66 0x66 0x64 0x64 0x64 0x66 0x66 0x64 0x64 0x64 0x64 0x64 0x64 0x64 0x67 0x6b 0x68 0x68 0x68 0x68 0x68 0x68 0x68 0x6a 0x63 0x61 0x61 0x61 0x61 0x61 0x61 0x61 0x64 0x67 0x66 0x66 0x66 0x64 0x64 0x64 0x64 0x66 0x66 0x64 0x64 0x64 0x64 0x64 0x64 0x64 0x67 0x6a 0x68 0x68 0x68 0x68 0x67 0x67 0x67 0x6a 0x61 0x60 0x60 0x60 0x60 0x60 0x60 0x60 0x63 0x67 0x66 0x66 0x66 0x66 0x66 0x64 0x64 0x66 0x67 0x66 0x66 0x66 0x66 0x66 0x66 0x66 0x68 0x68 0x67 0x67 0x67 0x67 0x67 0x66 0x67 0x68 0x63 0x61 0x61 0x61 0x61 0x61 0x61 0x61 0x64 0x67 0x66 0x66 0x66 0x66 0x66 0x66 0x66 0x67 0x68 0x67 0x67 0x67 0x67 0x67 0x67 0x67 0x6a 0x6b 0x6a 0x6a 0x6a 0x68 0x6a 0x68 0x6a 0x6b 0x63 0x61 0x61 0x61 0x61 0x61 0x61 0x61 0x64 0x68 0x66 0x67 0x67 0x66 0x67 0x66 0x67 0x68 0x61 0x61 0x60 0x61 0x60 0x60 0x60 0x61 0x63 0x68 0x66 0x67 0x67 0x66 0x66 0x66 0x67 0x68 0x63 0x61 0x61 0x61 0x61 0x61 0x61 0x61 0x64 0x68 0x67 0x67 0x67 0x66 0x67 0x67 0x67 0x68 0x63 0x61 0x61 0x61 0x61 0x61 0x61 0x61 0x64 0x68 0x66 0x66 0x66 0x66 0x66 0x66 0x67 0x68 0x64 0x63 0x63 0x63 0x63 0x63 0x63 0x63 0x66 0x6a 0x67 0x67 0x67 0x67 0x67 0x67 0x68 0x6a 0x64 0x63 0x63 0x63 0x63 0x63 0x63 0x63 0x66 0x67 0x66 0x66 0x66 0x64 0x64 0x66 0x66 0x67 0x64 0x61 0x61 0x61 0x61 0x61 0x61 0x61 0x64 0x68 0x66 0x66 0x66 0x66 0x66 0x66 0x67 0x68 0x60 0x63 0x63 0x63 0x63 0x61 0x61 0x63 0x64 0x68 0x66 0x66 0x67 0x66 0x66 0x66 0x67 0x64 0x5f 0x61 0x61 0x61 0x60 0x60 0x60 0x60 0x63 0x68 0x66 0x67 0x67 0x66 0x66 0x67 0x67 0x64 0x63 0x63 0x63 0x63 0x61 0x61 0x61 0x61 0x66 0x67 0x64 0x64 0x64 0x64 0x64 0x64 0x64 0x66 0x13a 0x13a 0x13a>;
					PS_Config_Lmt_FW_Diff_N = <0xffffffce 0xffffffce 0xffffffce 0xffffffce 0xffffffce 0xffffffce 0xffffffce 0xffffffce 0xffff0001 0xffff0001 0xffffffce 0xffffffce 0xffffffce 0xffffffce 0xffffffce 0xffffffce 0xffffffce 0xffffffce 0xffffffce 0xffffffce 0xffffffce 0xffffffce 0xffffffce 0xffffffce 0xffffffce 0xffffffce 0xffffffce 0xffffffce 0xffffffce 0xffffffce 0xffffffce 0xffffffce 0xffffffce 0xffffffce 0xffffffce 0xffffffce 0xffffffce 0xffffffce 0xffffffce 0xffffffce 0xffffffce 0xffffffce 0xffffffce 0xffffffce 0xffffffce 0xffffffce 0xffffffce 0xffffffce 0xffffffce 0xffffffce 0xffffffce 0xffffffce 0xffffffce 0xffffffce 0xffffffce 0xffffffce 0xffffffce 0xffffffce 0xffffffce 0xffffffce 0xffffffce 0xffffffce 0xffffffce 0xffffffce 0xffffffce 0xffffffce 0xffffffce 0xffffffce 0xffffffce 0xffffffce 0xffffffce 0xffffffce 0xffffffce 0xffffffce 0xffffffce 0xffffffce 0xffffffce 0xffffffce 0xffffffce 0xffffffce 0xffffffce 0xffffffce 0xffffffce 0xffffffce 0xffffffce 0xffffffce 0xffffffce 0xffffffce 0xffffffce 0xffffffce 0xffffffce 0xffffffce 0xffffffce 0xffffffce 0xffffffce 0xffffffce 0xffffffce 0xffffffce 0xffffffce 0xffffffce 0xffffffce 0xffffffce 0xffffffce 0xffffffce 0xffffffce 0xffffffce 0xffffffce 0xffffffce 0xffffffce 0xffffffce 0xffffffce 0xffffffce 0xffffffce 0xffffffce 0xffffffce 0xffffffce 0xffffffce 0xffffffce 0xffffffce 0xffffffce 0xffffffce 0xffffffce 0xffffffce 0xffffffce 0xffffffce 0xffffffce 0xffffffce 0xffffffce 0xffffffce 0xffffffce 0xffffffce 0xffffffce 0xffffffce 0xffffffce 0xffffffce 0xffffffce 0xffffffce 0xffffffce 0xffffffce 0xffffffce 0xffffffce 0xffffffce 0xffffffce 0xffffffce 0xffffffce 0xffffffce 0xffffffce 0xffffffce 0xffffffce 0xffffffce 0xffffffce 0xffffffce 0xffffffce 0xffffffce 0xffffffce 0xffffffce 0xffffffce 0xffffffce 0xffffffce 0xffffffce 0xffffffce 0xffffffce 0xffffffce 0xffffffce 0xffffffce 0xffffffce 0xffffffce 0xffffffce 0xffffffce 0xffffffce 0xffffffce 0xffffffce 0xffffffce 0xffffffce 0xffffffce 0xffffffce 0xffffffce 0xffffffce 0xffffffce 0xffffffce 0xffffffce 0xffffffce 0xffffffce 0xffffffce 0xffffffce 0xffffffce 0xffffffce 0xffffffce 0xffffffce 0xffffffce 0xffffffce 0xffffffce 0xffffffce 0xffffffce 0xffffffce 0xffffffce 0xffffffce 0xffffffce 0xffffffce 0xffffffce 0xffffffce 0xffffffce 0xffffffce 0xffffffce 0xffffffce 0xffffffce 0xffffffce 0xffffffce 0xffffffce 0xffffffce 0xffffffce 0xffffffce 0xffffffce 0xffffffce 0xffffffce 0xffffffce 0xffffffce 0xffffffce 0xffffffce 0xffffffce 0xffffffce 0xffffffce 0xffffffce 0xffffffce 0xffffffce 0xffffffce 0xffffffce 0xffffffce 0xffffffce 0xffffffce 0xffffffce 0xffffffce 0xffffffce 0xffffffce 0xffffffce 0xffffffce 0xffffffce 0xffffffce 0xffffffce 0xffffffce 0xffffffce 0xffffffce 0xffffffce 0xffffffce 0xffffffce 0xffffffce 0xffffffce 0xffffffce 0xffffffce 0xffffffce 0xffffffce 0xffffffce 0xffffffce 0xffffffce 0xffffffce 0xffffffce 0xffffffce 0xffffffce 0xffffffce 0xffffffce 0xffffffce 0xffffffce 0xffffffce 0xffffffce 0xffffffce 0xffffffce 0xffffffce 0xffffffce 0xffffffce 0xffffffce 0xffffffce 0xffffffce 0xffffffce 0xffffffce 0xffffffce 0xffffffce 0xffffffce 0xffffffce 0xffffffce 0xffffffce 0xffffffce 0xffffffce 0xffffffce 0xffffffce 0xffffffce 0xffffffce 0xffffffce 0xffffffce 0xffffffce 0xffffffce 0xffffffce 0xffffffce 0xffffffce 0xffffffce 0xffffffce 0xffffffce 0xffffffce 0xffffffce 0xffffffce 0xffffffce 0xffffffce 0xffffffce 0xffffffce 0xffffffce 0xffffffce 0xffffffce 0xffffffce 0xffffffce 0xffffffce 0xffffffce 0xffffffce 0xffffffce 0xffffffce 0xffffffce 0xffffffce 0xffffffce 0xffffffce 0xffffffce 0xffffffce 0xffffffce 0xffffffce 0xffffffce 0xffffffce 0xffffffce 0xffffffce 0xffffffce 0xffffffce 0xffffffce 0xffffffce 0xffffffce 0xffffffce 0xffffffce 0xffffffce 0xffffffce 0xffffffce 0xffffffce 0xffffffce 0xffffffce 0xffffffce 0xffffffce 0xffffffce 0xffffffce 0xffffffce 0xffffffce 0xffffffce 0xffffffce 0xffffffce 0xffffffce 0xffffffce 0xffffffce 0xffffffce 0xffffffce 0xffffffce 0xffffffce 0xffffffce 0xffffffce 0xffffffce 0xffffffce 0xffffffce 0xffffffce 0xffffffce 0xffffffce 0xffffffce 0xffffffce 0xffffffce 0xffffffce 0xffffffce 0xffffffce 0xffffffce 0xffffffce 0xffffffce 0xffffffce 0xffffffce 0xffffffce 0xffffffce 0xffffffce 0xffffffce 0xffffffce 0xffffffce 0xffffffce 0xffffffce 0xffffffce 0xffffffce 0xffffffce 0xffffffce 0xffffffce 0xffffffce 0xffffffce 0xffffffce 0xffffffce 0xffffffce 0xffffffce 0xffffffce 0xffffffce 0xffffffce 0xffffffce 0xffffffce 0xffffffce 0xffffffce 0xffffffce 0xffffffce 0xffffffce 0xffffffce 0xffffffce 0xffffffce 0xffffffce 0xffffffce 0xffffffce 0xffffffce 0xffffffce 0xffffffce 0xffffffce 0xffffffce 0xffffffce 0xffffffce 0xffffffce 0xffffffce 0xffffffce 0xffffffce 0xffffffce 0xffffffce 0xffffffce 0xffffffce 0xffffffce 0xffffffce 0xffffffce 0xffffffce 0xffffffce 0xffffffce 0xffffffce 0xffffffce 0xffffffce 0xffffffce 0xffffffce 0xffffffce 0xffffffce 0xffffffce 0xffffffce 0xffffffce 0xffffffce 0xffffffce 0xffffffce 0xffffffce 0xffffffce 0xffffffce 0xffffffce 0xffffffce 0xffffffce 0xffffffce 0xffffffce 0xffffffce 0xffffffce 0xffffffce 0xffffffce 0xffffffce 0xffffffce 0xffffffce 0xffffffce 0xffffffce 0xffffffce 0xffffffce 0xffffffce 0xffffffce 0xffffffce 0xffffffce 0xffffffce 0xffffffce 0xffffffce 0xffffffce 0xffffffce 0xffffffce 0xffffffce 0xffffffce 0xffffffce 0xffffffce 0xffffffce 0xffffffce 0xffffffce 0xffffffce 0xffffffce 0xffffffce 0xffffffce 0xffffffce 0xffffffce 0xffffffce 0xffffffce 0xffffffce 0xffffffce 0xffffffce 0xffffffce 0xffffffce 0xffffffce 0xffffffce 0xffffffce 0xffffffce 0xffffffce 0xffffffce 0xffffffce 0xffffffce 0xffffffce 0xffffffce 0xffffffce 0xffffffce 0xffffffce 0xffffffce 0xffffffce 0xffffffce 0xffffffce 0xffffffce 0xffffffce 0xffffffce 0xffffffce 0xffffffce 0xffffffce 0xffffffce 0xffffffce 0xffffffce 0xffffffce 0xffffffce 0xffffffce 0xffffffce 0xffffffce 0xffffffce 0xffffffce 0xffffffce 0xffffffce 0xffffffce 0xffffffce 0xffffffce 0xffffffce 0xffffffce 0xffffffce 0xffffffce 0xffffffce 0xffffffce 0xffffffce 0xffffffce 0xffffffce 0xffffffce 0xffffffce 0xffffffce 0xffffffce 0xffffffce 0xffffffce 0xffffffce 0xffffffce 0xffffffce 0xffffffce 0xffffffce 0xffffffce 0xffffffce 0xffffffce 0xffffffce 0xffffffce 0xffffffce 0xffffffce 0xffffffce 0xffffffce 0xffffffce 0xffffffce 0xffffffce 0xffffffce 0xffffffce 0xffffffce 0xffffffce 0xffffffce 0xffffffce 0xffffffce 0xffffffce 0xffffffce 0xffffffce 0xffffffce 0xffffffce 0xffffffce 0xffffffce 0xffffffce 0xffffffb5 0xffffffb5 0xffffffb5>;
					PS_Config_Lmt_FW_Diff_P = <0x32 0x32 0x32 0x32 0x32 0x32 0x32 0x32 0xffff 0xffff 0x32 0x32 0x32 0x32 0x32 0x32 0x32 0x32 0x32 0x32 0x32 0x32 0x32 0x32 0x32 0x32 0x32 0x32 0x32 0x32 0x32 0x32 0x32 0x32 0x32 0x32 0x32 0x32 0x32 0x32 0x32 0x32 0x32 0x32 0x32 0x32 0x32 0x32 0x32 0x32 0x32 0x32 0x32 0x32 0x32 0x32 0x32 0x32 0x32 0x32 0x32 0x32 0x32 0x32 0x32 0x32 0x32 0x32 0x32 0x32 0x32 0x32 0x32 0x32 0x32 0x32 0x32 0x32 0x32 0x32 0x32 0x32 0x32 0x32 0x32 0x32 0x32 0x32 0x32 0x32 0x32 0x32 0x32 0x32 0x32 0x32 0x32 0x32 0x32 0x32 0x32 0x32 0x32 0x32 0x32 0x32 0x32 0x32 0x32 0x32 0x32 0x32 0x32 0x32 0x32 0x32 0x32 0x32 0x32 0x32 0x32 0x32 0x32 0x32 0x32 0x32 0x32 0x32 0x32 0x32 0x32 0x32 0x32 0x32 0x32 0x32 0x32 0x32 0x32 0x32 0x32 0x32 0x32 0x32 0x32 0x32 0x32 0x32 0x32 0x32 0x32 0x32 0x32 0x32 0x32 0x32 0x32 0x32 0x32 0x32 0x32 0x32 0x32 0x32 0x32 0x32 0x32 0x32 0x32 0x32 0x32 0x32 0x32 0x32 0x32 0x32 0x32 0x32 0x32 0x32 0x32 0x32 0x32 0x32 0x32 0x32 0x32 0x32 0x32 0x32 0x32 0x32 0x32 0x32 0x32 0x32 0x32 0x32 0x32 0x32 0x32 0x32 0x32 0x32 0x32 0x32 0x32 0x32 0x32 0x32 0x32 0x32 0x32 0x32 0x32 0x32 0x32 0x32 0x32 0x32 0x32 0x32 0x32 0x32 0x32 0x32 0x32 0x32 0x32 0x32 0x32 0x32 0x32 0x32 0x32 0x32 0x32 0x32 0x32 0x32 0x32 0x32 0x32 0x32 0x32 0x32 0x32 0x32 0x32 0x32 0x32 0x32 0x32 0x32 0x32 0x32 0x32 0x32 0x32 0x32 0x32 0x32 0x32 0x32 0x32 0x32 0x32 0x32 0x32 0x32 0x32 0x32 0x32 0x32 0x32 0x32 0x32 0x32 0x32 0x32 0x32 0x32 0x32 0x32 0x32 0x32 0x32 0x32 0x32 0x32 0x32 0x32 0x32 0x32 0x32 0x32 0x32 0x32 0x32 0x32 0x32 0x32 0x32 0x32 0x32 0x32 0x32 0x32 0x32 0x32 0x32 0x32 0x32 0x32 0x32 0x32 0x32 0x32 0x32 0x32 0x32 0x32 0x32 0x32 0x32 0x32 0x32 0x32 0x32 0x32 0x32 0x32 0x32 0x32 0x32 0x32 0x32 0x32 0x32 0x32 0x32 0x32 0x32 0x32 0x32 0x32 0x32 0x32 0x32 0x32 0x32 0x32 0x32 0x32 0x32 0x32 0x32 0x32 0x32 0x32 0x32 0x32 0x32 0x32 0x32 0x32 0x32 0x32 0x32 0x32 0x32 0x32 0x32 0x32 0x32 0x32 0x32 0x32 0x32 0x32 0x32 0x32 0x32 0x32 0x32 0x32 0x32 0x32 0x32 0x32 0x32 0x32 0x32 0x32 0x32 0x32 0x32 0x32 0x32 0x32 0x32 0x32 0x32 0x32 0x32 0x32 0x32 0x32 0x32 0x32 0x32 0x32 0x32 0x32 0x32 0x32 0x32 0x32 0x32 0x32 0x32 0x32 0x32 0x32 0x32 0x32 0x32 0x32 0x32 0x32 0x32 0x32 0x32 0x32 0x32 0x32 0x32 0x32 0x32 0x32 0x32 0x32 0x32 0x32 0x32 0x32 0x32 0x32 0x32 0x32 0x32 0x32 0x32 0x32 0x32 0x32 0x32 0x32 0x32 0x32 0x32 0x32 0x32 0x32 0x32 0x32 0x32 0x32 0x32 0x32 0x32 0x32 0x32 0x32 0x32 0x32 0x32 0x32 0x32 0x32 0x32 0x32 0x32 0x32 0x32 0x32 0x32 0x32 0x32 0x32 0x32 0x32 0x32 0x32 0x32 0x32 0x32 0x32 0x32 0x32 0x32 0x32 0x32 0x32 0x32 0x32 0x32 0x32 0x32 0x32 0x32 0x32 0x32 0x32 0x32 0x32 0x32 0x32 0x32 0x32 0x32 0x32 0x32 0x32 0x32 0x32 0x32 0x32 0x32 0x32 0x32 0x32 0x32 0x32 0x32 0x32 0x32 0x32 0x32 0x32 0x32 0x32 0x32 0x32 0x32 0x32 0x32 0x32 0x32 0x32 0x32 0x32 0x32 0x32 0x32 0x32 0x32 0x32 0x32 0x32 0x32 0x32 0x32 0x32 0x32 0x32 0x32 0x32 0x32 0x32 0x32 0x32 0x32 0x32 0x32 0x32 0x4b 0x4b 0x4b>;
					PS_Config_Lmt_FW_Rawdata_N = <0x3b2 0x3c9 0x3b1 0x3be 0x3ba 0x3c6 0x3c3 0x3c1 0xffff0001 0xffff0001 0x3b8 0x3bc 0x3ba 0x3c6 0x3c6 0x3ce 0x3cc 0x3cc 0x3c0 0x3b8 0x3b1 0x3bd 0x3be 0x3ba 0x3c0 0x3ba 0x3be 0x3c9 0x3ba 0x3be 0x3c1 0x3b7 0x3b9 0x3bf 0x3c7 0x3c8 0x3ca 0x3bd 0x3b7 0x3c2 0x3ca 0x3c4 0x3c8 0x3d0 0x3c6 0x3ae 0x3c0 0x3c1 0x3c2 0x3c1 0x3c1 0x3c6 0x3cd 0x3bf 0x3c7 0x3bd 0x3bc 0x3c3 0x3cc 0x3c7 0x3c6 0x3bf 0x3ca 0x3b8 0x3c6 0x3cc 0x3d0 0x3b8 0x3be 0x3cc 0x3cb 0x3b0 0x3d0 0x3a9 0x3be 0x3b7 0x3ca 0x3c4 0x3c6 0x3cf 0x3ce 0x3b3 0x3ad 0x3af 0x3b4 0x3b5 0x3b7 0x3b8 0x3c9 0x3c9 0x3c3 0x3ad 0x3b1 0x3ac 0x3c4 0x3c2 0x3c8 0x3c9 0x3cd 0x3bd 0x3b0 0x3b5 0x3ba 0x3b4 0x3b6 0x3b0 0x3c5 0x3bd 0x3bc 0x3b9 0x3ba 0x3be 0x3be 0x3b8 0x3b9 0x3b3 0x3b8 0x3c3 0x3b3 0x3b6 0x3b0 0x3c8 0x3c1 0x3c6 0x3bb 0x3cd 0x3be 0x3d2 0x3ce 0x3db 0x3d0 0x3c8 0x3d7 0x3c7 0x3d4 0x3c0 0x3ba 0x3ba 0x3bb 0x3c3 0x3c0 0x3c1 0x3c0 0x3be 0x3b5 0x3c9 0x3c1 0x3cd 0x3c0 0x3bd 0x3c9 0x3cf 0x3c5 0x3bc 0x3be 0x3ba 0x3bb 0x3b0 0x3cd 0x3be 0x3c2 0x3c0 0x3b2 0x3c9 0x3c4 0x3c5 0x3bd 0x3bd 0x3bd 0x3c0 0x3bc 0x3b8 0x3bf 0x3c0 0x3b7 0x3b9 0x3b8 0x3c6 0x3c4 0x3bd 0x3b6 0x3c3 0x3af 0x3c0 0x3aa 0x3b4 0x3af 0x3b5 0x3b1 0x3c8 0x3c8 0x3bf 0x3c4 0x3c7 0x3c9 0x3bb 0x3c1 0x3c2 0x3b0 0x3c7 0x3c9 0x3c8 0x3cd 0x3c5 0x3cc 0x3cd 0x3ca 0x3ca 0x3c0 0x3bf 0x3c0 0x3c6 0x3cd 0x3c4 0x3c9 0x3c6 0x3c9 0x3c0 0x3bb 0x3be 0x3b5 0x3ba 0x3bc 0x3c6 0x3be 0x3c6 0x3b4 0x3b8 0x3b1 0x3c7 0x3c4 0x3c3 0x3c4 0x3b9 0x3b2 0x3c6 0x3c3 0x3bb 0x3c7 0x3c5 0x3c4 0x3c4 0x3c1 0x3bb 0x3ca 0x3c3 0x3c6 0x3c2 0x3bd 0x3b7 0x3bd 0x3c2 0x3d5 0x3bc 0x3ba 0x3b7 0x3b4 0x3b9 0x3af 0x3b7 0x3af 0x3ba 0x3b7 0x3bd 0x3ba 0x3b1 0x3c7 0x3bf 0x3c9 0x3c0 0x3b2 0x3bf 0x3bf 0x3b9 0x3ca 0x3cd 0x3c9 0x3c6 0x3c3 0x3b8 0x3ce 0x3d0 0x3d0 0x3bd 0x3bd 0x3c0 0x3be 0x3c3 0x3c5 0x3c0 0x3b7 0x3bb 0x3bb 0x3c0 0x3bc 0x3c1 0x3c2 0x3c0 0x3c0 0x3c4 0x3c3 0x3ca 0x3bf 0x3c2 0x3c4 0x3ca 0x3b9 0x3c3 0x3bf 0x3c4 0x3c4 0x3c1 0x3c9 0x3c8 0x3c5 0x3ca 0x3c4 0x3c2 0x3c4 0x3c0 0x3c9 0x3cc 0x3c3 0x3b8 0x3c4 0x3c4 0x3c3 0x3be 0x3c6 0x3ca 0x3c9 0x3c4 0x3c5 0x3c6 0x3c3 0x3be 0x3be 0x3cf 0x3cc 0x3c3 0x3cc 0x3c5 0x3bc 0x3c4 0x3be 0x3c8 0x3ba 0x3c7 0x3c7 0x3be 0x3ca 0x3cc 0x3bb 0x3b9 0x3bb 0x3be 0x3bc 0x3c0 0x3b8 0x3b5 0x3b7 0x3bf 0x3c5 0x3c3 0x3ba 0x3b9 0x3b7 0x3b8 0x3b7 0x3ba 0x3bf 0x3c2 0x3c0 0x3c4 0x3c9 0x3be 0x3c3 0x3c3 0x3c3 0x3c0 0x3c4 0x3c4 0x3c5 0x3bc 0x3c0 0x3ca 0x3bf 0x3cf 0x3cd 0x3bf 0x3bd 0x3cf 0x3cc 0x3d5 0x3cd 0x3b2 0x3bb 0x3c3 0x3c3 0x3bb 0x3bf 0x3cc 0x3c5 0x3ba 0x3c7 0x3b2 0x3b8 0x3b9 0x3b9 0x3c0 0x3b4 0x3bc 0x3be 0x3bd 0x3c1 0x3bd 0x3b7 0x3c4 0x3bc 0x3bf 0x3c2 0x3ba 0x3c3 0x3b4 0x3cf 0x3bb 0x3b7 0x3cd 0x3cd 0x3ce 0x3c0 0x3b8 0x3ba 0x3cf 0x3c8 0x3cc 0x3ca 0x3c6 0x3c6 0x3c9 0x3c1 0x3b3 0x3c3 0x3c9 0x3ca 0x3c4 0x3cc 0x3c5 0x3cf 0x3aa 0x3b6 0x3c8 0x3c5 0x3be 0x3c3 0x3c8 0x3c6 0x3bc 0x3c9 0x3c3 0x3be 0x3bb 0x3bc 0x3b8 0x3c1 0x3c1 0x3c2 0x3ca 0x3c5 0x3b6 0x3ba 0x3b6 0x3b1 0x3be 0x3b2 0x3ac 0x3b8 0x3b8 0x3b9 0x3b7 0x3b4 0x3bb 0x3c4 0x3c0 0x3c0 0x3b7 0x3c3 0x3c0 0x3b5 0x3b3 0x3c7 0x3c4 0x3c1 0x3b9 0x3c0 0x3d2 0x3bc 0x3c1 0x3c1 0x3ba 0x3ba 0x3be 0x3c9 0x3c4 0x3c1 0x3bb 0x3c0 0x3c9 0x3c6 0x3cc 0x3ce 0x3c7 0x3cf 0x3c3 0x3bf 0x3b7 0x3b7 0x3be 0x3b7 0x3bc 0x3c0 0x3bc 0x3c5 0x3b9 0x3a4 0x3a8 0x3a4 0x3bd 0x3bc 0x3a4 0x3b4 0x3be 0x3bd 0x3b8 0x3bd 0x3b6 0x3bc 0x3c0 0x3c7 0x3c8 0x3c7 0x3cc 0x3b1 0x3b1 0x3b4 0x3b3 0x3ab 0x3ab 0x3bb 0x3c4 0x3c0 0x3ba 0x3bb 0x3bd 0x3c6 0x3c1 0x3ba 0x3b8 0x3c0 0x3b5 0x3ae 0x3b0 0x3be 0x3c1 0x3c3 0x3bd 0x3b6 0x3c3 0x3bb 0x3be 0x3be 0x3c3 0x3c7 0x3b8 0x3cd 0x3b5 0xf0 0xf0 0xf0>;
					PS_Config_Lmt_FW_Rawdata_P = <0x89f 0x8d5 0x89e 0x8bd 0x8b2 0x8cf 0x8c7 0x8c4 0xffff 0xffff 0x8af 0x8b7 0x8b3 0x8cf 0x8ce 0x8e1 0x8dd 0x8dc 0x8c0 0x8af 0x89d 0x8b9 0x8bd 0x8b3 0x8c1 0x8b3 0x8bb 0x8d5 0x8b2 0x8bd 0x8c2 0x8ab 0x8b0 0x8be 0x8d2 0x8d3 0x8d9 0x8b9 0x8ab 0x8c5 0x8d7 0x8c9 0x8d3 0x8e5 0x8cf 0x897 0x8c0 0x8c2 0x8c5 0x8c2 0x8c4 0x8ce 0x8e0 0x8be 0x8d2 0x8b9 0x8b7 0x8c7 0x8dc 0x8d2 0x8cf 0x8be 0x8d7 0x8af 0x8ce 0x8dc 0x8e7 0x8ad 0x8bd 0x8dc 0x8da 0x89b 0x8e5 0x88a 0x8bb 0x8ac 0x8d9 0x8c9 0x8cf 0x8e4 0x8e1 0x8a2 0x894 0x89a 0x8a4 0x8a6 0x8ab 0x8af 0x8d6 0x8d5 0x8c7 0x894 0x89e 0x891 0x8c9 0x8c5 0x8d3 0x8d6 0x8e0 0x8ba 0x89b 0x8a8 0x8b2 0x8a5 0x8a9 0x89b 0x8cc 0x8ba 0x8b7 0x8b0 0x8b2 0x8bd 0x8bd 0x8ad 0x8b0 0x8a2 0x8af 0x8c7 0x8a2 0x8a9 0x89b 0x8d3 0x8c2 0x8cf 0x8b4 0x8e0 0x8bb 0x8ea 0x8e1 0x900 0x8e5 0x8d3 0x8f6 0x8d0 0x8ef 0x8c0 0x8b3 0x8b2 0x8b6 0x8c8 0x8c1 0x8c4 0x8c1 0x8bb 0x8a6 0x8d6 0x8c4 0x8de 0x8c1 0x8ba 0x8d5 0x8e3 0x8cc 0x8b7 0x8bd 0x8b3 0x8b4 0x89b 0x8e0 0x8bb 0x8c5 0x8c1 0x8a1 0x8d6 0x8cb 0x8cc 0x8b9 0x8ba 0x8b9 0x8c1 0x8b7 0x8ad 0x8be 0x8c0 0x8ab 0x8b0 0x8af 0x8cf 0x8c9 0x8ba 0x8a9 0x8c7 0x898 0x8c1 0x88d 0x8a5 0x898 0x8a6 0x89e 0x8d3 0x8d3 0x8be 0x8c9 0x8d0 0x8d6 0x8b4 0x8c2 0x8c5 0x89b 0x8d0 0x8d6 0x8d3 0x8de 0x8cc 0x8dd 0x8e0 0x8d9 0x8d9 0x8c1 0x8be 0x8c0 0x8cf 0x8e0 0x8cb 0x8d5 0x8ce 0x8d5 0x8c0 0x8b4 0x8bb 0x8a6 0x8b2 0x8b7 0x8cf 0x8bb 0x8ce 0x8a4 0x8ad 0x89e 0x8d2 0x8c9 0x8c7 0x8cb 0x8b0 0x8a1 0x8cf 0x8c8 0x8b4 0x8d0 0x8cc 0x8cb 0x8c9 0x8c2 0x8b4 0x8d7 0x8c7 0x8cf 0x8c5 0x8ba 0x8ac 0x8ba 0x8c5 0x8f2 0x8b7 0x8b2 0x8ac 0x8a5 0x8b0 0x89a 0x8ab 0x89a 0x8b3 0x8ab 0x8ba 0x8b3 0x89d 0x8d0 0x8be 0x8d5 0x8c1 0x89f 0x8be 0x8be 0x8b0 0x8d9 0x8de 0x8d6 0x8cf 0x8c8 0x8af 0x8e1 0x8e7 0x8e5 0x8b9 0x8ba 0x8c1 0x8bb 0x8c7 0x8cc 0x8c1 0x8ab 0x8b4 0x8b6 0x8c0 0x8b7 0x8c2 0x8c5 0x8c1 0x8c0 0x8cb 0x8c7 0x8d9 0x8be 0x8c5 0x8cb 0x8d7 0x8b0 0x8c8 0x8be 0x8cb 0x8c9 0x8c2 0x8d5 0x8d3 0x8cc 0x8d9 0x8c9 0x8c5 0x8c9 0x8c0 0x8d5 0x8dd 0x8c8 0x8ad 0x8cb 0x8c9 0x8c8 0x8bd 0x8ce 0x8d7 0x8d5 0x8cb 0x8cc 0x8cf 0x8c8 0x8bd 0x8bb 0x8e3 0x8dc 0x8c8 0x8dc 0x8cc 0x8b7 0x8c9 0x8bb 0x8d3 0x8b3 0x8d2 0x8d0 0x8bb 0x8d7 0x8dd 0x8b4 0x8b0 0x8b6 0x8bd 0x8b7 0x8c0 0x8af 0x8a8 0x8ab 0x8be 0x8cc 0x8c8 0x8b2 0x8b0 0x8ac 0x8ad 0x8ab 0x8b2 0x8be 0x8c5 0x8c1 0x8c9 0x8d5 0x8bd 0x8c8 0x8c7 0x8c8 0x8c0 0x8c9 0x8cb 0x8cc 0x8b7 0x8c1 0x8d7 0x8be 0x8e4 0x8de 0x8be 0x8b9 0x8e4 0x8dd 0x8f1 0x8e0 0x89f 0x8b6 0x8c8 0x8c8 0x8b6 0x8be 0x8dc 0x8cc 0x8b3 0x8d0 0x89f 0x8af 0x8b0 0x8b0 0x8c1 0x8a5 0x8b7 0x8bd 0x8ba 0x8c4 0x8b9 0x8ab 0x8c9 0x8b7 0x8be 0x8c5 0x8b3 0x8c7 0x8a5 0x8e3 0x8b4 0x8ab 0x8de 0x8de 0x8e1 0x8c1 0x8af 0x8b3 0x8e4 0x8d3 0x8dd 0x8d9 0x8ce 0x8cf 0x8d5 0x8c2 0x8a2 0x8c7 0x8d5 0x8d9 0x8c9 0x8dc 0x8cc 0x8e3 0x88d 0x8a9 0x8d3 0x8cc 0x8bb 0x8c8 0x8d3 0x8ce 0x8b7 0x8d5 0x8c7 0x8bb 0x8b6 0x8b7 0x8af 0x8c4 0x8c2 0x8c5 0x8d9 0x8cc 0x8a9 0x8b3 0x8a9 0x89d 0x8bd 0x8a1 0x893 0x8ad 0x8ad 0x8b0 0x8ab 0x8a4 0x8b6 0x8cb 0x8c1 0x8c0 0x8ab 0x8c8 0x8c0 0x8a6 0x8a2 0x8d0 0x8c9 0x8c2 0x8b0 0x8c1 0x8eb 0x8b7 0x8c4 0x8c2 0x8b3 0x8b3 0x8bb 0x8d5 0x8c9 0x8c2 0x8b4 0x8c0 0x8d6 0x8cf 0x8dc 0x8e1 0x8d0 0x8e3 0x8c7 0x8be 0x8ac 0x8ac 0x8bd 0x8ac 0x8b7 0x8c1 0x8b7 0x8cc 0x8b0 0x87f 0x889 0x87f 0x8b9 0x8b7 0x87f 0x8a4 0x8bb 0x8ba 0x8ad 0x8ba 0x8a9 0x8b7 0x8c1 0x8d0 0x8d3 0x8d2 0x8dd 0x89d 0x89d 0x8a4 0x8a2 0x88f 0x88f 0x8b6 0x8c9 0x8c0 0x8b3 0x8b4 0x8ba 0x8cf 0x8c2 0x8b3 0x8af 0x8c0 0x8a8 0x897 0x89b 0x8bb 0x8c2 0x8c7 0x8b9 0x8a9 0x8c8 0x8b4 0x8bb 0x8bd 0x8c8 0x8d2 0x8ad 0x8e0 0x8a8 0xf00 0xf00 0xf00>;
					PS_Config_Lmt_Open_Rawdata_N = <0x5a8 0x5a6 0x5ab 0x5bc 0x5cd 0x5c3 0x5bc 0x5c7 0xffff0001 0xffff0001 0x59c 0x58f 0x599 0x5a3 0x5a6 0x5aa 0x5a9 0x590 0x552 0x549 0x555 0x567 0x579 0x579 0x576 0x571 0x567 0x55f 0x56f 0x571 0x577 0x577 0x577 0x578 0x56d 0x55a 0x547 0x53c 0x545 0x558 0x56a 0x56a 0x565 0x561 0x553 0x53b 0x54c 0x552 0x556 0x556 0x558 0x55a 0x551 0x546 0x55f 0x552 0x55e 0x573 0x587 0x589 0x585 0x580 0x571 0x568 0x57c 0x582 0x586 0x587 0x587 0x588 0x57f 0x574 0x572 0x566 0x571 0x585 0x59a 0x59a 0x595 0x591 0x582 0x55c 0x56e 0x574 0x57a 0x57b 0x57b 0x57d 0x576 0x56b 0x562 0x555 0x55f 0x573 0x589 0x58e 0x589 0x585 0x576 0x57f 0x592 0x598 0x59e 0x5a0 0x5a0 0x5a0 0x59b 0x591 0x564 0x55b 0x55f 0x563 0x565 0x564 0x567 0x562 0x554 0x572 0x57a 0x580 0x57e 0x57a 0x565 0x54c 0x53b 0x52d 0x591 0x589 0x58e 0x594 0x595 0x596 0x597 0x594 0x585 0x5a4 0x5ad 0x5b0 0x5b0 0x5af 0x599 0x57c 0x56a 0x55b 0x590 0x587 0x58e 0x595 0x596 0x598 0x597 0x595 0x586 0x5a4 0x5ad 0x5b1 0x5b4 0x5b1 0x59c 0x580 0x570 0x55f 0x59c 0x593 0x59c 0x5a2 0x5a4 0x5a6 0x5a6 0x5a1 0x593 0x5b9 0x5c2 0x5c8 0x5ca 0x5c8 0x5b2 0x595 0x585 0x574 0x5af 0x5a4 0x5ac 0x5b2 0x5b2 0x5b3 0x5b3 0x5ae 0x5a0 0x5b8 0x5c3 0x5c7 0x5c8 0x5c7 0x5b6 0x59b 0x58b 0x57b 0x591 0x585 0x58c 0x591 0x591 0x592 0x58e 0x58b 0x57d 0x59c 0x5a7 0x5ac 0x5b1 0x5b1 0x5a3 0x58c 0x57e 0x56f 0x5af 0x5a4 0x5b4 0x5b9 0x5bb 0x5b9 0x5b6 0x5b2 0x5a8 0x5c2 0x5c8 0x5cc 0x5d3 0x5d2 0x5c2 0x5aa 0x595 0x586 0x5c1 0x5b6 0x5c5 0x5cd 0x5cc 0x5cd 0x5c8 0x5c3 0x5bc 0x5d0 0x5d5 0x5da 0x5e1 0x5e1 0x5d5 0x5be 0x5a9 0x59a 0x5cb 0x5bf 0x5cd 0x5d3 0x5d2 0x5d3 0x5cc 0x5c8 0x5c1 0x5c7 0x5cc 0x5d0 0x5d7 0x5da 0x5cd 0x5ba 0x5a5 0x597 0x5b2 0x5a5 0x5af 0x5b3 0x5b2 0x5b2 0x5ac 0x5a8 0x5a0 0x5ad 0x5b3 0x5b8 0x5bd 0x5bf 0x5b7 0x5aa 0x599 0x58c 0x5d9 0x5ce 0x5da 0x5db 0x5dc 0x5dc 0x5d9 0x5d5 0x5cd 0x5d8 0x5df 0x5e5 0x5e8 0x5e9 0x5e1 0x5d4 0x5c0 0x5af 0x5e5 0x5d9 0x5e3 0x5e6 0x5e5 0x5e6 0x5e3 0x5e0 0x5d7 0x5e0 0x5e6 0x5ed 0x5f1 0x5f1 0x5eb 0x5e1 0x5d0 0x5c1 0x5f3 0x5e5 0x5ef 0x5f0 0x5f1 0x5f1 0x5ee 0x5e8 0x5e0 0x5dd 0x5e4 0x5e9 0x5ef 0x5f0 0x5ed 0x5e1 0x5d3 0x5c7 0x5ce 0x5bb 0x5c2 0x5c5 0x5c4 0x5c2 0x5bf 0x5b9 0x5b2 0x5c1 0x5c8 0x5ce 0x5d3 0x5d6 0x5d4 0x5cb 0x5be 0x5b5 0x5f9 0x5e6 0x5ee 0x5f2 0x5f1 0x5f1 0x5ee 0x5e9 0x5df 0x5e9 0x5f2 0x5f7 0x5fb 0x5fd 0x5fd 0x5f1 0x5e3 0x5da 0x609 0x5f3 0x5fb 0x600 0x5fe 0x5fd 0x5fa 0x5f5 0x5ec 0x5f1 0x5fa 0x600 0x604 0x607 0x608 0x5fe 0x5f1 0x5e8 0x612 0x5fd 0x601 0x609 0x608 0x607 0x603 0x5fe 0x5f5 0x5e3 0x5ec 0x5f2 0x5f7 0x5f8 0x5fc 0x5f7 0x5ee 0x5e8 0x5e2 0x5ca 0x5ca 0x5cf 0x5ce 0x5ce 0x5ca 0x5c5 0x5bc 0x5ca 0x5d2 0x5d7 0x5dc 0x5e0 0x5e4 0x5e4 0x5dc 0x5d8 0x61b 0x604 0x607 0x60d 0x60c 0x60c 0x607 0x602 0x5fa 0x5ea 0x5f2 0x5f8 0x5fd 0x601 0x606 0x606 0x5fd 0x5fa 0x612 0x5f7 0x5f8 0x5fc 0x5fb 0x5fa 0x5f7 0x5f2 0x5ea 0x604 0x60c 0x612 0x616 0x61a 0x61f 0x621 0x619 0x617 0x631 0x616 0x617 0x61b 0x619 0x618 0x616 0x612 0x60b 0x5f8 0x601 0x608 0x60b 0x60d 0x612 0x613 0x610 0x60f 0x5f1 0x5d4 0x5d3 0x5d2 0x5d0 0x5ce 0x5cd 0x5c8 0x5c1 0x5d4 0x5dc 0x5e2 0x5e6 0x5e9 0x5ee 0x5f4 0x5f2 0x5f2 0x634 0x617 0x614 0x613 0x611 0x610 0x60d 0x609 0x601 0x5ee 0x5f5 0x5fc 0x600 0x604 0x60a 0x610 0x60f 0x611 0x552 0x604 0x601 0x600 0x5ff 0x5fd 0x5fa 0x5f5 0x5ef 0x606 0x60d 0x613 0x618 0x61c 0x622 0x629 0x628 0x553 0x561 0x619 0x612 0x60f 0x60c 0x609 0x607 0x603 0x5fd 0x5f4 0x5fb 0x600 0x604 0x609 0x60d 0x615 0x618 0x545 0x5c3 0x5bf 0x5c8 0x5c1 0x5bc 0x5bb 0x5ba 0x5ba 0x5b8 0x5c8 0x5cb 0x5cc 0x5ce 0x5d3 0x5da 0x5e4 0x5d9 0x5c2 0xfffffe01 0xfffffe01 0xfffffe01>;
					PS_Config_Lmt_Open_Rawdata_P = <0xd33 0xd2f 0xd3a 0xd61 0xd89 0xd72 0xd63 0xd7c 0xffff 0xffff 0xd17 0xcf8 0xd10 0xd28 0xd2e 0xd39 0xd35 0xcfb 0xc6b 0xc55 0xc71 0xc9c 0xcc5 0xcc5 0xcbf 0xcb4 0xc9c 0xc88 0xcae 0xcb4 0xcc0 0xcc0 0xcc2 0xcc3 0xca9 0xc7d 0xc50 0xc37 0xc4c 0xc79 0xca2 0xca2 0xc96 0xc8e 0xc6e 0xc36 0xc5c 0xc6a 0xc73 0xc75 0xc78 0xc7d 0xc68 0xc4f 0xc8a 0xc6b 0xc87 0xcb7 0xce6 0xcea 0xce1 0xcd5 0xcb4 0xc9d 0xccc 0xcda 0xce5 0xce6 0xce6 0xce9 0xcd3 0xcb9 0xcb5 0xc99 0xcb2 0xce2 0xd12 0xd13 0xd08 0xcfd 0xcda 0xc81 0xcad 0xcbb 0xcc7 0xcca 0xcca 0xcce 0xcbe 0xca6 0xc91 0xc71 0xc8a 0xcb8 0xcea 0xcf6 0xcec 0xce1 0xcbe 0xcd3 0xd01 0xd0f 0xd1d 0xd21 0xd20 0xd21 0xd16 0xcfe 0xc95 0xc80 0xc88 0xc92 0xc98 0xc95 0xc9c 0xc91 0xc6f 0xcb5 0xcc7 0xcd7 0xcd1 0xcc9 0xc98 0xc5c 0xc36 0xc14 0xcfe 0xcea 0xcf7 0xd04 0xd06 0xd09 0xd0c 0xd05 0xce2 0xd29 0xd3e 0xd47 0xd47 0xd43 0xd10 0xccd 0xca3 0xc7f 0xcfb 0xce6 0xcf6 0xd06 0xd09 0xd0d 0xd0b 0xd08 0xce3 0xd29 0xd40 0xd48 0xd4f 0xd48 0xd17 0xcd7 0xcb0 0xc88 0xd17 0xd02 0xd17 0xd25 0xd2b 0xd2e 0xd2e 0xd24 0xd02 0xd5a 0xd71 0xd7f 0xd83 0xd7f 0xd4b 0xd08 0xce2 0xcb9 0xd43 0xd29 0xd3d 0xd4a 0xd4b 0xd4e 0xd4c 0xd41 0xd21 0xd58 0xd72 0xd7c 0xd7f 0xd7c 0xd53 0xd16 0xcf0 0xcca 0xcfd 0xce2 0xcf1 0xcfe 0xcfe 0xcff 0xcf7 0xcef 0xcd0 0xd17 0xd30 0xd3d 0xd48 0xd48 0xd28 0xcf1 0xcd1 0xcae 0xd44 0xd2b 0xd4f 0xd5a 0xd5f 0xd5c 0xd53 0xd4a 0xd33 0xd6f 0xd7d 0xd87 0xd97 0xd95 0xd6f 0xd37 0xd06 0xce5 0xd6e 0xd55 0xd78 0xd89 0xd87 0xd8a 0xd7d 0xd72 0xd63 0xd90 0xd9c 0xda7 0xdb8 0xdb8 0xd9c 0xd66 0xd36 0xd12 0xd84 0xd6a 0xd8a 0xd97 0xd95 0xd97 0xd87 0xd7f 0xd6e 0xd7b 0xd87 0xd91 0xda2 0xda7 0xd8a 0xd5d 0xd2c 0xd0b 0xd4b 0xd2c 0xd44 0xd4e 0xd4a 0xd4b 0xd3d 0xd33 0xd21 0xd40 0xd4c 0xd58 0xd64 0xd68 0xd56 0xd37 0xd10 0xcf1 0xda6 0xd8b 0xda7 0xdaa 0xdac 0xdad 0xda6 0xd9c 0xd8a 0xda3 0xdb3 0xdc1 0xdc9 0xdca 0xdb8 0xd99 0xd6b 0xd44 0xdc1 0xda6 0xdbe 0xdc3 0xdc2 0xdc5 0xdbc 0xdb5 0xda2 0xdb5 0xdc5 0xdd4 0xddd 0xdde 0xdcf 0xdb8 0xd90 0xd6d 0xde2 0xdc2 0xdd8 0xddb 0xddd 0xdde 0xdd6 0xdc9 0xdb5 0xdae 0xdbf 0xdcc 0xdd8 0xddb 0xdd4 0xdb8 0xd98 0xd7c 0xd8d 0xd60 0xd71 0xd76 0xd74 0xd6f 0xd68 0xd5c 0xd4b 0xd6d 0xd7f 0xd8b 0xd97 0xd9e 0xd9b 0xd84 0xd67 0xd52 0xdf0 0xdc3 0xdd7 0xde1 0xddd 0xddd 0xdd6 0xdca 0xdb4 0xdca 0xddf 0xdeb 0xdf6 0xdfa 0xdf9 0xddd 0xdbe 0xda7 0xe15 0xde2 0xdf6 0xe00 0xdfb 0xdf9 0xdf2 0xde6 0xdd1 0xddd 0xdf2 0xe01 0xe0b 0xe10 0xe13 0xdfd 0xdde 0xdc9 0xe2b 0xdfa 0xe04 0xe15 0xe13 0xe10 0xe08 0xdfd 0xde8 0xdbe 0xdd3 0xddf 0xdeb 0xdef 0xdf7 0xdec 0xdd7 0xdc9 0xdba 0xd83 0xd83 0xd8e 0xd8b 0xd8b 0xd83 0xd76 0xd61 0xd82 0xd95 0xda2 0xdad 0xdb5 0xdbf 0xdbf 0xdad 0xda3 0xe40 0xe0b 0xe10 0xe1e 0xe1d 0xe1c 0xe12 0xe05 0xdf3 0xdcd 0xde1 0xded 0xdfa 0xe02 0xe0f 0xe0e 0xdfa 0xdf3 0xe2b 0xdec 0xdef 0xdf7 0xdf6 0xdf3 0xdeb 0xddf 0xdcd 0xe09 0xe1d 0xe2b 0xe35 0xe3d 0xe48 0xe4d 0xe3c 0xe36 0xe72 0xe35 0xe36 0xe3f 0xe3c 0xe38 0xe33 0xe2a 0xe1a 0xdef 0xe02 0xe13 0xe1a 0xe20 0xe2a 0xe2e 0xe25 0xe23 0xdde 0xd9b 0xd97 0xd95 0xd91 0xd8d 0xd89 0xd7d 0xd6e 0xd9b 0xdad 0xdbb 0xdc3 0xdcc 0xdd7 0xde4 0xddf 0xddf 0xe7b 0xe36 0xe2f 0xe2e 0xe28 0xe25 0xe20 0xe15 0xe04 0xdd7 0xde8 0xdf7 0xe01 0xe09 0xe17 0xe27 0xe24 0xe28 0xc6a 0xe0b 0xe04 0xe01 0xdfe 0xdf9 0xdf3 0xde8 0xdda 0xe0e 0xe20 0xe2e 0xe39 0xe43 0xe51 0xe60 0xe5d 0xc6c 0xc8e 0xe3a 0xe2b 0xe23 0xe1c 0xe16 0xe10 0xe07 0xdf9 0xde5 0xdf4 0xe00 0xe0b 0xe15 0xe20 0xe31 0xe38 0xc4c 0xd72 0xd68 0xd7f 0xd6d 0xd61 0xd5f 0xd5d 0xd5d 0xd59 0xd7d 0xd84 0xd87 0xd8b 0xd97 0xda7 0xdbf 0xda6 0xd6f 0x1400 0x1400 0x1400>;
					PS_Config_Lmt_Short_Rawdata_N = <0x2c70 0x2c70 0x2c70 0x2c70 0x2c70 0x2c70 0x2c70 0x2c70 0x2c70 0x2c70 0x2c70 0x2c70 0x2c70 0x2c70 0x2c70 0x2c70 0x2c70 0x2c70 0x2c70 0x2c70 0x2c70 0x2c70 0x2c70 0x2c70 0x2c70 0x2c70 0x2c70 0x2c70 0x2c70 0x2c70 0x2c70 0x2c70 0x2c70 0x2c70 0x2c70 0x2c70 0x2c70 0x2c70 0x2c70 0x2c70 0x2c70 0x2c70 0x2c70 0x2c70 0x2c70 0x2c70 0x2c70 0x2c70 0x2c70 0x2c70 0x2c70 0x2c70 0x2c70 0x2c70 0x2c70 0x2c70 0x2c70 0x2c70 0x2c70 0x2c70 0x2c70 0x2c70 0x2c70 0x2c70 0x2c70 0x2c70 0x2c70 0x2c70 0x2c70 0x2c70 0x2c70 0x2c70 0x2c70 0x2c70 0x2c70 0x2c70 0x2c70 0x2c70 0x2c70 0x2c70 0x2c70 0x2c70 0x2c70 0x2c70 0x2c70 0x2c70 0x2c70 0x2c70 0x2c70 0x2c70 0x2c70 0x2c70 0x2c70 0x2c70 0x2c70 0x2c70 0x2c70 0x2c70 0x2c70 0x2c70 0x2c70 0x2c70 0x2c70 0x2c70 0x2c70 0x2c70 0x2c70 0x2c70 0x2c70 0x2c70 0x2c70 0x2c70 0x2c70 0x2c70 0x2c70 0x2c70 0x2c70 0x2c70 0x2c70 0x2c70 0x2c70 0x2c70 0x2c70 0x2c70 0x2c70 0x2c70 0x2c70 0x2c70 0x2c70 0x2c70 0x2c70 0x2c70 0x2c70 0x2c70 0x2c70 0x2c70 0x2c70 0x2c70 0x2c70 0x2c70 0x2c70 0x2c70 0x2c70 0x2c70 0x2c70 0x2c70 0x2c70 0x2c70 0x2c70 0x2c70 0x2c70 0x2c70 0x2c70 0x2c70 0x2c70 0x2c70 0x2c70 0x2c70 0x2c70 0x2c70 0x2c70 0x2c70 0x2c70 0x2c70 0x2c70 0x2c70 0x2c70 0x2c70 0x2c70 0x2c70 0x2c70 0x2c70 0x2c70 0x2c70 0x2c70 0x2c70 0x2c70 0x2c70 0x2c70 0x2c70 0x2c70 0x2c70 0x2c70 0x2c70 0x2c70 0x2c70 0x2c70 0x2c70 0x2c70 0x2c70 0x2c70 0x2c70 0x2c70 0x2c70 0x2c70 0x2c70 0x2c70 0x2c70 0x2c70 0x2c70 0x2c70 0x2c70 0x2c70 0x2c70 0x2c70 0x2c70 0x2c70 0x2c70 0x2c70 0x2c70 0x2c70 0x2c70 0x2c70 0x2c70 0x2c70 0x2c70 0x2c70 0x2c70 0x2c70 0x2c70 0x2c70 0x2c70 0x2c70 0x2c70 0x2c70 0x2c70 0x2c70 0x2c70 0x2c70 0x2c70 0x2c70 0x2c70 0x2c70 0x2c70 0x2c70 0x2c70 0x2c70 0x2c70 0x2c70 0x2c70 0x2c70 0x2c70 0x2c70 0x2c70 0x2c70 0x2c70 0x2c70 0x2c70 0x2c70 0x2c70 0x2c70 0x2c70 0x2c70 0x2c70 0x2c70 0x2c70 0x2c70 0x2c70 0x2c70 0x2c70 0x2c70 0x2c70 0x2c70 0x2c70 0x2c70 0x2c70 0x2c70 0x2c70 0x2c70 0x2c70 0x2c70 0x2c70 0x2c70 0x2c70 0x2c70 0x2c70 0x2c70 0x2c70 0x2c70 0x2c70 0x2c70 0x2c70 0x2c70 0x2c70 0x2c70 0x2c70 0x2c70 0x2c70 0x2c70 0x2c70 0x2c70 0x2c70 0x2c70 0x2c70 0x2c70 0x2c70 0x2c70 0x2c70 0x2c70 0x2c70 0x2c70 0x2c70 0x2c70 0x2c70 0x2c70 0x2c70 0x2c70 0x2c70 0x2c70 0x2c70 0x2c70 0x2c70 0x2c70 0x2c70 0x2c70 0x2c70 0x2c70 0x2c70 0x2c70 0x2c70 0x2c70 0x2c70 0x2c70 0x2c70 0x2c70 0x2c70 0x2c70 0x2c70 0x2c70 0x2c70 0x2c70 0x2c70 0x2c70 0x2c70 0x2c70 0x2c70 0x2c70 0x2c70 0x2c70 0x2c70 0x2c70 0x2c70 0x2c70 0x2c70 0x2c70 0x2c70 0x2c70 0x2c70 0x2c70 0x2c70 0x2c70 0x2c70 0x2c70 0x2c70 0x2c70 0x2c70 0x2c70 0x2c70 0x2c70 0x2c70 0x2c70 0x2c70 0x2c70 0x2c70 0x2c70 0x2c70 0x2c70 0x2c70 0x2c70 0x2c70 0x2c70 0x2c70 0x2c70 0x2c70 0x2c70 0x2c70 0x2c70 0x2c70 0x2c70 0x2c70 0x2c70 0x2c70 0x2c70 0x2c70 0x2c70 0x2c70 0x2c70 0x2c70 0x2c70 0x2c70 0x2c70 0x2c70 0x2c70 0x2c70 0x2c70 0x2c70 0x2c70 0x2c70 0x2c70 0x2c70 0x2c70 0x2c70 0x2c70 0x2c70 0x2c70 0x2c70 0x2c70 0x2c70 0x2c70 0x2c70 0x2c70 0x2c70 0x2c70 0x2c70 0x2c70 0x2c70 0x2c70 0x2c70 0x2c70 0x2c70 0x2c70 0x2c70 0x2c70 0x2c70 0x2c70 0x2c70 0x2c70 0x2c70 0x2c70 0x2c70 0x2c70 0x2c70 0x2c70 0x2c70 0x2c70 0x2c70 0x2c70 0x2c70 0x2c70 0x2c70 0x2c70 0x2c70 0x2c70 0x2c70 0x2c70 0x2c70 0x2c70 0x2c70 0x2c70 0x2c70 0x2c70 0x2c70 0x2c70 0x2c70 0x2c70 0x2c70 0x2c70 0x2c70 0x2c70 0x2c70 0x2c70 0x2c70 0x2c70 0x2c70 0x2c70 0x2c70 0x2c70 0x2c70 0x2c70 0x2c70 0x2c70 0x2c70 0x2c70 0x2c70 0x2c70 0x2c70 0x2c70 0x2c70 0x2c70 0x2c70 0x2c70 0x2c70 0x2c70 0x2c70 0x2c70 0x2c70 0x2c70 0x2c70 0x2c70 0x2c70 0x2c70 0x2c70 0x2c70 0x2c70 0x2c70 0x2c70 0x2c70 0x2c70 0x2c70 0x2c70 0x2c70 0x2c70 0x2c70 0x2c70 0x2c70 0x2c70 0x2c70 0x2c70 0x2c70 0x2c70 0x2c70 0x2c70 0x2c70 0x2c70 0x2c70 0x2c70 0x2c70 0x2c70 0x2c70 0x2c70 0x2c70 0x2c70 0x2c70 0x2c70 0x2c70 0x2c70 0x2c70 0x2c70 0x2c70 0x2c70 0x2c70 0x2c70 0x2c70 0x2c70 0x2c70 0x2c70 0x2c70 0x2c70 0x2c70 0x2c70 0x2c70 0x2c70 0x2c70 0x2c70 0x2c70 0x2c70 0x2c70 0x2c70 0x2c70 0x2c70 0x2c70 0x2c70 0x2c70 0x2c70 0x2c70 0x2c70 0x2c70 0x2c70 0x2c70 0x2c70 0x2c70 0x2c70 0x2c70 0x2c70 0x2c70 0x2c70 0x2c70 0x2c70 0x2c70 0x2c70 0x2c70 0x2c70 0x2c70 0x2c70 0x2c70 0x2c70 0x2710 0x2710 0x2710>;
					PS_Config_Lmt_Short_Rawdata_P = <0x36b8 0x36b8 0x36b8 0x36b8 0x36b8 0x36b8 0x36b8 0x36b8 0x36b8 0x36b8 0x36b8 0x36b8 0x36b8 0x36b8 0x36b8 0x36b8 0x36b8 0x36b8 0x36b8 0x36b8 0x36b8 0x36b8 0x36b8 0x36b8 0x36b8 0x36b8 0x36b8 0x36b8 0x36b8 0x36b8 0x36b8 0x36b8 0x36b8 0x36b8 0x36b8 0x36b8 0x36b8 0x36b8 0x36b8 0x36b8 0x36b8 0x36b8 0x36b8 0x36b8 0x36b8 0x36b8 0x36b8 0x36b8 0x36b8 0x36b8 0x36b8 0x36b8 0x36b8 0x36b8 0x36b8 0x36b8 0x36b8 0x36b8 0x36b8 0x36b8 0x36b8 0x36b8 0x36b8 0x36b8 0x36b8 0x36b8 0x36b8 0x36b8 0x36b8 0x36b8 0x36b8 0x36b8 0x36b8 0x36b8 0x36b8 0x36b8 0x36b8 0x36b8 0x36b8 0x36b8 0x36b8 0x36b8 0x36b8 0x36b8 0x36b8 0x36b8 0x36b8 0x36b8 0x36b8 0x36b8 0x36b8 0x36b8 0x36b8 0x36b8 0x36b8 0x36b8 0x36b8 0x36b8 0x36b8 0x36b8 0x36b8 0x36b8 0x36b8 0x36b8 0x36b8 0x36b8 0x36b8 0x36b8 0x36b8 0x36b8 0x36b8 0x36b8 0x36b8 0x36b8 0x36b8 0x36b8 0x36b8 0x36b8 0x36b8 0x36b8 0x36b8 0x36b8 0x36b8 0x36b8 0x36b8 0x36b8 0x36b8 0x36b8 0x36b8 0x36b8 0x36b8 0x36b8 0x36b8 0x36b8 0x36b8 0x36b8 0x36b8 0x36b8 0x36b8 0x36b8 0x36b8 0x36b8 0x36b8 0x36b8 0x36b8 0x36b8 0x36b8 0x36b8 0x36b8 0x36b8 0x36b8 0x36b8 0x36b8 0x36b8 0x36b8 0x36b8 0x36b8 0x36b8 0x36b8 0x36b8 0x36b8 0x36b8 0x36b8 0x36b8 0x36b8 0x36b8 0x36b8 0x36b8 0x36b8 0x36b8 0x36b8 0x36b8 0x36b8 0x36b8 0x36b8 0x36b8 0x36b8 0x36b8 0x36b8 0x36b8 0x36b8 0x36b8 0x36b8 0x36b8 0x36b8 0x36b8 0x36b8 0x36b8 0x36b8 0x36b8 0x36b8 0x36b8 0x36b8 0x36b8 0x36b8 0x36b8 0x36b8 0x36b8 0x36b8 0x36b8 0x36b8 0x36b8 0x36b8 0x36b8 0x36b8 0x36b8 0x36b8 0x36b8 0x36b8 0x36b8 0x36b8 0x36b8 0x36b8 0x36b8 0x36b8 0x36b8 0x36b8 0x36b8 0x36b8 0x36b8 0x36b8 0x36b8 0x36b8 0x36b8 0x36b8 0x36b8 0x36b8 0x36b8 0x36b8 0x36b8 0x36b8 0x36b8 0x36b8 0x36b8 0x36b8 0x36b8 0x36b8 0x36b8 0x36b8 0x36b8 0x36b8 0x36b8 0x36b8 0x36b8 0x36b8 0x36b8 0x36b8 0x36b8 0x36b8 0x36b8 0x36b8 0x36b8 0x36b8 0x36b8 0x36b8 0x36b8 0x36b8 0x36b8 0x36b8 0x36b8 0x36b8 0x36b8 0x36b8 0x36b8 0x36b8 0x36b8 0x36b8 0x36b8 0x36b8 0x36b8 0x36b8 0x36b8 0x36b8 0x36b8 0x36b8 0x36b8 0x36b8 0x36b8 0x36b8 0x36b8 0x36b8 0x36b8 0x36b8 0x36b8 0x36b8 0x36b8 0x36b8 0x36b8 0x36b8 0x36b8 0x36b8 0x36b8 0x36b8 0x36b8 0x36b8 0x36b8 0x36b8 0x36b8 0x36b8 0x36b8 0x36b8 0x36b8 0x36b8 0x36b8 0x36b8 0x36b8 0x36b8 0x36b8 0x36b8 0x36b8 0x36b8 0x36b8 0x36b8 0x36b8 0x36b8 0x36b8 0x36b8 0x36b8 0x36b8 0x36b8 0x36b8 0x36b8 0x36b8 0x36b8 0x36b8 0x36b8 0x36b8 0x36b8 0x36b8 0x36b8 0x36b8 0x36b8 0x36b8 0x36b8 0x36b8 0x36b8 0x36b8 0x36b8 0x36b8 0x36b8 0x36b8 0x36b8 0x36b8 0x36b8 0x36b8 0x36b8 0x36b8 0x36b8 0x36b8 0x36b8 0x36b8 0x36b8 0x36b8 0x36b8 0x36b8 0x36b8 0x36b8 0x36b8 0x36b8 0x36b8 0x36b8 0x36b8 0x36b8 0x36b8 0x36b8 0x36b8 0x36b8 0x36b8 0x36b8 0x36b8 0x36b8 0x36b8 0x36b8 0x36b8 0x36b8 0x36b8 0x36b8 0x36b8 0x36b8 0x36b8 0x36b8 0x36b8 0x36b8 0x36b8 0x36b8 0x36b8 0x36b8 0x36b8 0x36b8 0x36b8 0x36b8 0x36b8 0x36b8 0x36b8 0x36b8 0x36b8 0x36b8 0x36b8 0x36b8 0x36b8 0x36b8 0x36b8 0x36b8 0x36b8 0x36b8 0x36b8 0x36b8 0x36b8 0x36b8 0x36b8 0x36b8 0x36b8 0x36b8 0x36b8 0x36b8 0x36b8 0x36b8 0x36b8 0x36b8 0x36b8 0x36b8 0x36b8 0x36b8 0x36b8 0x36b8 0x36b8 0x36b8 0x36b8 0x36b8 0x36b8 0x36b8 0x36b8 0x36b8 0x36b8 0x36b8 0x36b8 0x36b8 0x36b8 0x36b8 0x36b8 0x36b8 0x36b8 0x36b8 0x36b8 0x36b8 0x36b8 0x36b8 0x36b8 0x36b8 0x36b8 0x36b8 0x36b8 0x36b8 0x36b8 0x36b8 0x36b8 0x36b8 0x36b8 0x36b8 0x36b8 0x36b8 0x36b8 0x36b8 0x36b8 0x36b8 0x36b8 0x36b8 0x36b8 0x36b8 0x36b8 0x36b8 0x36b8 0x36b8 0x36b8 0x36b8 0x36b8 0x36b8 0x36b8 0x36b8 0x36b8 0x36b8 0x36b8 0x36b8 0x36b8 0x36b8 0x36b8 0x36b8 0x36b8 0x36b8 0x36b8 0x36b8 0x36b8 0x36b8 0x36b8 0x36b8 0x36b8 0x36b8 0x36b8 0x36b8 0x36b8 0x36b8 0x36b8 0x36b8 0x36b8 0x36b8 0x36b8 0x36b8 0x36b8 0x36b8 0x36b8 0x36b8 0x36b8 0x36b8 0x36b8 0x36b8 0x36b8 0x36b8 0x36b8 0x36b8 0x36b8 0x36b8 0x36b8 0x36b8 0x36b8 0x36b8 0x36b8 0x36b8 0x36b8 0x36b8 0x36b8 0x36b8 0x36b8 0x36b8 0x36b8 0x36b8 0x36b8 0x36b8 0x36b8 0x36b8 0x36b8 0x36b8 0x36b8 0x36b8 0x36b8 0x36b8 0x36b8 0x36b8 0x36b8 0x36b8 0x36b8 0x36b8 0x36b8 0x36b8 0x36b8 0x36b8 0x36b8 0x36b8 0x36b8 0x36b8 0x36b8 0x36b8 0x36b8 0x36b8 0x36b8 0x36b8 0x36b8 0x36b8 0x36b8 0x36b8 0x36b8 0x36b8 0x36b8 0x36b8 0x36b8 0x36b8 0x36b8 0x36b8 0x36b8 0x36b8>;
					X_Channel = <0x12>;
					Y_Channel = <0x20>;
					compatible = "novatek-mp-criteria-5970";
				};
			};
		};
	};

	fragment@73 {
		target = <0xffffffff>;

		__overlay__ {

			fs15xx_cmd {
				phandle = <0x46>;

				pins_cmd_dat {
					bias-disable;
					pinmux = <0xb300>;
					slew-rate = <0x1>;
				};
			};

			fs15xx_id {
				phandle = <0x45>;

				pins_cmd_dat {
					bias-disable;
					pinmux = <0x0>;
					slew-rate = <0x1>;
				};
			};

			fs15xx_mod {
				phandle = <0x47>;

				pins_cmd_dat {
					bias-disable;
					pinmux = <0x400>;
					slew-rate = <0x1>;
				};
			};
		};
	};

	fragment@74 {
		target = <0xffffffff>;

		__overlay__ {

			fs15xx {
				compatible = "foursemi,fs15xx";
				fsm,cmd-gpio = <0xffffffff 0xb3 0x0>;
				fsm,dev-type = <0x1>;
				fsm,id-gpio = <0xffffffff 0x0 0x0>;
				fsm,mod-gpio = <0xffffffff 0x4 0x0>;
				phandle = <0x62>;
				pinctrl-0 = <0x45>;
				pinctrl-1 = <0x46>;
				pinctrl-2 = <0x47>;
				pinctrl-names = "fs15xx_id_default", "fs15xx_cmd_default", "fs15xx_mod_default";
				status = "okay";
			};
		};
	};

	fragment@8 {
		target = <0xffffffff>;

		__overlay__ {

			reserve-memory-scp_share {
				alignment = <0x0 0x1000000>;
				alloc-ranges = <0x0 0x40000000 0x0 0x50000000>;
				compatible = "mediatek,reserve-memory-scp_share";
				no-map;
				size = <0x0 0xd00000>;
			};
		};
	};

	fragment@9 {
		target = <0xffffffff>;

		__overlay__ {
			atag,videolfb-fb_base_h = <0x0>;
			atag,videolfb-fb_base_l = "~`P";
			atag,videolfb-fps = <0x1770>;
			atag,videolfb-islcm_inited = <0x0>;
			atag,videolfb-islcmfound = <0x1>;
			atag,videolfb-lcmname = "hx83112b_fhdp_dsi_cmd_auo_rt5081_drv";
			atag,videolfb-vramSize = <0x17e8000>;
		};
	};
};
